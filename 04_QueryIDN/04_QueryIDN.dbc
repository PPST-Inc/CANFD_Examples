VERSION ""

NS_ :

BS_:

BU_: PPS_Device Client_PC

BO_ 3221225472 VECTOR__INDEPENDENT_SIG_MSG: 0 Vector__XXX
 SG_ SC_CSC_Enable : 0|8@1+ (1,0) [0|255] "" Vector__XXX
 SG_ SS_Faults_Reset : 0|8@1+ (1,0) [0|255] "" Vector__XXX
 SG_ GS_Fault : 0|8@1+ (1,0) [0|255] "" Vector__XXX
 SG_ GS_Faults_Index : 0|64@1+ (1,0) [0|0] "" Vector__XXX
 SG_ PM_ALL_Frequency : 0|32@1- (1,0) [-3.4E+038|3.4E+038] "Hz" Vector__XXX
 SG_ PM_ALL_Voltage_AC : 0|32@1- (1,0) [-3.4E+038|3.4E+038] "V" Vector__XXX
 SG_ PM_ALL_Voltage_ACDC : 0|32@1- (1,0) [-3.4E+038|3.4E+038] "V" Vector__XXX
 SG_ PM_ALL_Voltage_DC : 0|32@1- (1,0) [-3.4E+038|3.4E+038] "V" Vector__XXX
 SG_ PM_ALL_Voltage_THD : 0|32@1- (1,0) [-3.4E+038|3.4E+038] "" Vector__XXX
 SG_ PM_ALL_VoltageLL_AC : 0|32@1- (1,0) [-3.4E+038|3.4E+038] "V" Vector__XXX
 SG_ PM_ALL_VoltageLL_ACDC : 0|32@1- (1,0) [-3.4E+038|3.4E+038] "V" Vector__XXX
 SG_ PM_ALL_VoltageLL_DC : 0|32@1- (1,0) [-3.4E+038|3.4E+038] "V" Vector__XXX
 SG_ PM_ALL_Current_ACDC : 0|32@1- (1,0) [-3.4E+038|3.4E+038] "A" Vector__XXX
 SG_ PM_ALL_Current_DC : 0|32@1- (1,0) [-3.4E+038|3.4E+038] "A" Vector__XXX
 SG_ PM_ALL_Current_THD : 0|32@1- (1,0) [-3.4E+038|3.4E+038] "" Vector__XXX
 SG_ PM_ALL_Crest_Factor : 0|32@1- (1,0) [-3.4E+038|3.4E+038] "" Vector__XXX
 SG_ PM_ALL_Peak_Current : 0|32@1- (1,0) [-3.4E+038|3.4E+038] "A" Vector__XXX
 SG_ PM_ALL_Peak_Current_Recoded : 0|32@1- (1,0) [-3.4E+038|3.4E+038] "A" Vector__XXX
 SG_ PM_ALL_Active_Power : 0|32@1- (1,0) [-3.4E+038|3.4E+038] "kW" Vector__XXX
 SG_ PM_ALL_Power_Factor : 0|32@1- (1,0) [-3.4E+038|3.4E+038] "" Vector__XXX
 SG_ PM_ALL_Power_Factor_Angle : 0|32@1- (1,0) [-3.4E+038|3.4E+038] "Deg" Vector__XXX
 SG_ PM_ALL_Displacement_Factor : 0|32@1- (1,0) [-3.4E+038|3.4E+038] "" Vector__XXX
 SG_ PM_ALL_Distortion_Factor : 0|32@1- (1,0) [-3.4E+038|3.4E+038] "" Vector__XXX
 SG_ PM_ALL_Kilowatt_Hour : 0|32@1- (1,0) [-3.4E+038|3.4E+038] "kWh" Vector__XXX
 SG_ PM_ALL_KWH_Elapsed_Time : 0|32@1- (1,0) [-3.4E+038|3.4E+038] "s" Vector__XXX
 SG_ PM_A_Frequency : 0|32@1- (1,0) [-3.4E+038|3.4E+038] "Hz" Vector__XXX
 SG_ PM_A_Voltage_AC : 0|32@1- (1,0) [-3.4E+038|3.4E+038] "V" Vector__XXX
 SG_ PM_A_Voltage_ACDC : 0|32@1- (1,0) [-3.4E+038|3.4E+038] "V" Vector__XXX
 SG_ PM_A_Voltage_DC : 0|32@1- (1,0) [-3.4E+038|3.4E+038] "V" Vector__XXX
 SG_ PM_A_Voltage_THD : 0|32@1- (1,0) [-3.4E+038|3.4E+038] "" Vector__XXX
 SG_ PM_A_VoltageLL_AC : 0|32@1- (1,0) [-3.4E+038|3.4E+038] "V" Vector__XXX
 SG_ PM_A_VoltageLL_ACDC : 0|32@1- (1,0) [-3.4E+038|3.4E+038] "V" Vector__XXX
 SG_ PM_A_VoltageLL_DC : 0|32@1- (1,0) [-3.4E+038|3.4E+038] "V" Vector__XXX
 SG_ PM_A_Current_ACDC : 0|32@1- (1,0) [-3.4E+038|3.4E+038] "A" Vector__XXX
 SG_ PM_A_Current_DC : 0|32@1- (1,0) [-3.4E+038|3.4E+038] "A" Vector__XXX
 SG_ PM_A_Current_THD : 0|32@1- (1,0) [-3.4E+038|3.4E+038] "" Vector__XXX
 SG_ PM_A_Crest_Factor : 0|32@1- (1,0) [-3.4E+038|3.4E+038] "" Vector__XXX
 SG_ PM_A_Peak_Current : 0|32@1- (1,0) [-3.4E+038|3.4E+038] "A" Vector__XXX
 SG_ PM_A_Peak_Current_Recoded : 0|32@1- (1,0) [-3.4E+038|3.4E+038] "A" Vector__XXX
 SG_ PM_A_Active_Power : 0|32@1- (1,0) [-3.4E+038|3.4E+038] "kW" Vector__XXX
 SG_ PM_A_Power_Factor : 0|32@1- (1,0) [-3.4E+038|3.4E+038] "" Vector__XXX
 SG_ PM_A_Power_Factor_Angle : 0|32@1- (1,0) [-3.4E+038|3.4E+038] "Deg" Vector__XXX
 SG_ PM_A_Displacement_Factor : 0|32@1- (1,0) [-3.4E+038|3.4E+038] "" Vector__XXX
 SG_ PM_A_Distortion_Factor : 0|32@1- (1,0) [-3.4E+038|3.4E+038] "" Vector__XXX
 SG_ PM_A_Kilowatt_Hour : 0|32@1- (1,0) [-3.4E+038|3.4E+038] "kWh" Vector__XXX
 SG_ PM_A_KWH_Elapsed_Time : 0|32@1- (1,0) [-3.4E+038|3.4E+038] "s" Vector__XXX
 SG_ PM_B_Frequency : 0|32@1- (1,0) [-3.4E+038|3.4E+038] "Hz" Vector__XXX
 SG_ PM_B_Voltage_AC : 0|32@1- (1,0) [-3.4E+038|3.4E+038] "V" Vector__XXX
 SG_ PM_B_Voltage_ACDC : 0|32@1- (1,0) [-3.4E+038|3.4E+038] "V" Vector__XXX
 SG_ PM_B_Voltage_DC : 0|32@1- (1,0) [-3.4E+038|3.4E+038] "V" Vector__XXX
 SG_ PM_B_Voltage_THD : 0|32@1- (1,0) [-3.4E+038|3.4E+038] "" Vector__XXX
 SG_ PM_B_VoltageLL_AC : 0|32@1- (1,0) [-3.4E+038|3.4E+038] "V" Vector__XXX
 SG_ PM_B_VoltageLL_ACDC : 0|32@1- (1,0) [-3.4E+038|3.4E+038] "V" Vector__XXX
 SG_ PM_B_VoltageLL_DC : 0|32@1- (1,0) [-3.4E+038|3.4E+038] "V" Vector__XXX
 SG_ PM_B_Current_ACDC : 0|32@1- (1,0) [-3.4E+038|3.4E+038] "A" Vector__XXX
 SG_ PM_B_Current_DC : 0|32@1- (1,0) [-3.4E+038|3.4E+038] "A" Vector__XXX
 SG_ PM_B_Current_THD : 0|32@1- (1,0) [-3.4E+038|3.4E+038] "" Vector__XXX
 SG_ PM_B_Crest_Factor : 0|32@1- (1,0) [-3.4E+038|3.4E+038] "" Vector__XXX
 SG_ PM_B_Peak_Current : 0|32@1- (1,0) [-3.4E+038|3.4E+038] "A" Vector__XXX
 SG_ PM_B_Peak_Current_Recoded : 0|32@1- (1,0) [-3.4E+038|3.4E+038] "A" Vector__XXX
 SG_ PM_B_Active_Power : 0|32@1- (1,0) [-3.4E+038|3.4E+038] "kW" Vector__XXX
 SG_ PM_B_Power_Factor : 0|32@1- (1,0) [-3.4E+038|3.4E+038] "" Vector__XXX
 SG_ PM_B_Power_Factor_Angle : 0|32@1- (1,0) [-3.4E+038|3.4E+038] "Deg" Vector__XXX
 SG_ PM_B_Displacement_Factor : 0|32@1- (1,0) [-3.4E+038|3.4E+038] "" Vector__XXX
 SG_ PM_B_Distortion_Factor : 0|32@1- (1,0) [-3.4E+038|3.4E+038] "" Vector__XXX
 SG_ PM_B_Kilowatt_Hour : 0|32@1- (1,0) [-3.4E+038|3.4E+038] "kWh" Vector__XXX
 SG_ PM_B_KWH_Elapsed_Time : 0|32@1- (1,0) [-3.4E+038|3.4E+038] "s" Vector__XXX
 SG_ PM_C_Frequency : 0|32@1- (1,0) [-3.4E+038|3.4E+038] "Hz" Vector__XXX
 SG_ PM_C_Voltage_AC : 0|32@1- (1,0) [-3.4E+038|3.4E+038] "V" Vector__XXX
 SG_ PM_C_Voltage_ACDC : 0|32@1- (1,0) [-3.4E+038|3.4E+038] "V" Vector__XXX
 SG_ PM_C_Voltage_DC : 0|32@1- (1,0) [-3.4E+038|3.4E+038] "V" Vector__XXX
 SG_ PM_C_Voltage_THD : 0|32@1- (1,0) [-3.4E+038|3.4E+038] "" Vector__XXX
 SG_ PM_C_VoltageLL_AC : 0|32@1- (1,0) [-3.4E+038|3.4E+038] "V" Vector__XXX
 SG_ PM_C_VoltageLL_ACDC : 0|32@1- (1,0) [-3.4E+038|3.4E+038] "V" Vector__XXX
 SG_ PM_C_VoltageLL_DC : 0|32@1- (1,0) [-3.4E+038|3.4E+038] "V" Vector__XXX
 SG_ PM_C_Current_ACDC : 0|32@1- (1,0) [-3.4E+038|3.4E+038] "A" Vector__XXX
 SG_ PM_C_Current_DC : 0|32@1- (1,0) [-3.4E+038|3.4E+038] "A" Vector__XXX
 SG_ PM_C_Current_THD : 0|32@1- (1,0) [-3.4E+038|3.4E+038] "" Vector__XXX
 SG_ PM_C_Crest_Factor : 0|32@1- (1,0) [-3.4E+038|3.4E+038] "" Vector__XXX
 SG_ PM_C_Peak_Current : 0|32@1- (1,0) [-3.4E+038|3.4E+038] "A" Vector__XXX
 SG_ PM_C_Peak_Current_Recoded : 0|32@1- (1,0) [-3.4E+038|3.4E+038] "A" Vector__XXX
 SG_ PM_C_Active_Power : 0|32@1- (1,0) [-3.4E+038|3.4E+038] "kW" Vector__XXX
 SG_ PM_C_Power_Factor : 0|32@1- (1,0) [-3.4E+038|3.4E+038] "" Vector__XXX
 SG_ PM_C_Power_Factor_Angle : 0|32@1- (1,0) [-3.4E+038|3.4E+038] "Deg" Vector__XXX
 SG_ PM_C_Displacement_Factor : 0|32@1- (1,0) [-3.4E+038|3.4E+038] "" Vector__XXX
 SG_ PM_C_Distortion_Factor : 0|32@1- (1,0) [-3.4E+038|3.4E+038] "" Vector__XXX
 SG_ PM_C_Kilowatt_Hour : 0|32@1- (1,0) [-3.4E+038|3.4E+038] "kWh" Vector__XXX
 SG_ PM_C_KWH_Elapsed_Time : 0|32@1- (1,0) [-3.4E+038|3.4E+038] "s" Vector__XXX
 SG_ GM_ALL_Frequency : 0|32@1- (1,0) [-3.4E+038|3.4E+038] "Hz" Vector__XXX
 SG_ GM_ALL_Voltage_AC : 0|32@1- (1,0) [-3.4E+038|3.4E+038] "V" Vector__XXX
 SG_ GM_ALL_Voltage_ACDC : 0|32@1- (1,0) [-3.4E+038|3.4E+038] "V" Vector__XXX
 SG_ GM_ALL_Voltage_DC : 0|32@1- (1,0) [-3.4E+038|3.4E+038] "V" Vector__XXX
 SG_ GM_ALL_Voltage_THD : 0|32@1- (1,0) [-3.4E+038|3.4E+038] "" Vector__XXX
 SG_ GM_ALL_VoltageLL_AC : 0|32@1- (1,0) [-3.4E+038|3.4E+038] "V" Vector__XXX
 SG_ GM_ALL_VoltageLL_ACDC : 0|32@1- (1,0) [-3.4E+038|3.4E+038] "V" Vector__XXX
 SG_ GM_ALL_VoltageLL_DC : 0|32@1- (1,0) [-3.4E+038|3.4E+038] "V" Vector__XXX
 SG_ GM_ALL_Current_ACDC : 0|32@1- (1,0) [-3.4E+038|3.4E+038] "A" Vector__XXX
 SG_ GM_ALL_Current_DC : 0|32@1- (1,0) [-3.4E+038|3.4E+038] "A" Vector__XXX
 SG_ GM_ALL_Current_THD : 0|32@1- (1,0) [-3.4E+038|3.4E+038] "" Vector__XXX
 SG_ GM_ALL_Crest_Factor : 0|32@1- (1,0) [-3.4E+038|3.4E+038] "" Vector__XXX
 SG_ GM_ALL_Peak_Current : 0|32@1- (1,0) [-3.4E+038|3.4E+038] "A" Vector__XXX
 SG_ GM_ALL_Peak_Current_Recoded : 0|32@1- (1,0) [-3.4E+038|3.4E+038] "A" Vector__XXX
 SG_ GM_ALL_Active_Power : 0|32@1- (1,0) [-3.4E+038|3.4E+038] "kW" Vector__XXX
 SG_ GM_ALL_Power_Factor : 0|32@1- (1,0) [-3.4E+038|3.4E+038] "" Vector__XXX
 SG_ GM_ALL_Power_Factor_Angle : 0|32@1- (1,0) [-3.4E+038|3.4E+038] "Deg" Vector__XXX
 SG_ GM_ALL_Displacement_Factor : 0|32@1- (1,0) [-3.4E+038|3.4E+038] "" Vector__XXX
 SG_ GM_ALL_Distortion_Factor : 0|32@1- (1,0) [-3.4E+038|3.4E+038] "" Vector__XXX
 SG_ GM_ALL_Kilowatt_Hour : 0|32@1- (1,0) [-3.4E+038|3.4E+038] "kWh" Vector__XXX
 SG_ GM_ALL_KWH_Elapsed_Time : 0|32@1- (1,0) [-3.4E+038|3.4E+038] "s" Vector__XXX
 SG_ GM_A_Frequency : 0|32@1- (1,0) [-3.4E+038|3.4E+038] "Hz" Vector__XXX
 SG_ GM_A_Voltage_AC : 0|32@1- (1,0) [-3.4E+038|3.4E+038] "V" Vector__XXX
 SG_ GM_A_Voltage_ACDC : 0|32@1- (1,0) [-3.4E+038|3.4E+038] "V" Vector__XXX
 SG_ GM_A_Voltage_DC : 0|32@1- (1,0) [-3.4E+038|3.4E+038] "V" Vector__XXX
 SG_ GM_A_Voltage_THD : 0|32@1- (1,0) [-3.4E+038|3.4E+038] "" Vector__XXX
 SG_ GM_A_VoltageLL_AC : 0|32@1- (1,0) [-3.4E+038|3.4E+038] "V" Vector__XXX
 SG_ GM_A_VoltageLL_ACDC : 0|32@1- (1,0) [-3.4E+038|3.4E+038] "V" Vector__XXX
 SG_ GM_A_VoltageLL_DC : 0|32@1- (1,0) [-3.4E+038|3.4E+038] "V" Vector__XXX
 SG_ GM_A_Current_ACDC : 0|32@1- (1,0) [-3.4E+038|3.4E+038] "A" Vector__XXX
 SG_ GM_A_Current_DC : 0|32@1- (1,0) [-3.4E+038|3.4E+038] "A" Vector__XXX
 SG_ GM_A_Current_THD : 0|32@1- (1,0) [-3.4E+038|3.4E+038] "" Vector__XXX
 SG_ GM_A_Crest_Factor : 0|32@1- (1,0) [-3.4E+038|3.4E+038] "" Vector__XXX
 SG_ GM_A_Peak_Current : 0|32@1- (1,0) [-3.4E+038|3.4E+038] "A" Vector__XXX
 SG_ GM_A_Peak_Current_Recoded : 0|32@1- (1,0) [-3.4E+038|3.4E+038] "A" Vector__XXX
 SG_ GM_A_Active_Power : 0|32@1- (1,0) [-3.4E+038|3.4E+038] "kW" Vector__XXX
 SG_ GM_A_Power_Factor : 0|32@1- (1,0) [-3.4E+038|3.4E+038] "" Vector__XXX
 SG_ GM_A_Power_Factor_Angle : 0|32@1- (1,0) [-3.4E+038|3.4E+038] "Deg" Vector__XXX
 SG_ GM_A_Displacement_Factor : 0|32@1- (1,0) [-3.4E+038|3.4E+038] "" Vector__XXX
 SG_ GM_A_Distortion_Factor : 0|32@1- (1,0) [-3.4E+038|3.4E+038] "" Vector__XXX
 SG_ GM_A_Kilowatt_Hour : 0|32@1- (1,0) [-3.4E+038|3.4E+038] "kWh" Vector__XXX
 SG_ GM_A_KWH_Elapsed_Time : 0|32@1- (1,0) [-3.4E+038|3.4E+038] "s" Vector__XXX
 SG_ GM_B_Frequency : 0|32@1- (1,0) [-3.4E+038|3.4E+038] "Hz" Vector__XXX
 SG_ GM_B_Voltage_AC : 0|32@1- (1,0) [-3.4E+038|3.4E+038] "V" Vector__XXX
 SG_ GM_B_Voltage_ACDC : 0|32@1- (1,0) [-3.4E+038|3.4E+038] "V" Vector__XXX
 SG_ GM_B_Voltage_DC : 0|32@1- (1,0) [-3.4E+038|3.4E+038] "V" Vector__XXX
 SG_ GM_B_Voltage_THD : 0|32@1- (1,0) [-3.4E+038|3.4E+038] "" Vector__XXX
 SG_ GM_B_VoltageLL_AC : 0|32@1- (1,0) [-3.4E+038|3.4E+038] "V" Vector__XXX
 SG_ GM_B_VoltageLL_ACDC : 0|32@1- (1,0) [-3.4E+038|3.4E+038] "V" Vector__XXX
 SG_ GM_B_VoltageLL_DC : 0|32@1- (1,0) [-3.4E+038|3.4E+038] "V" Vector__XXX
 SG_ GM_B_Current_ACDC : 0|32@1- (1,0) [-3.4E+038|3.4E+038] "A" Vector__XXX
 SG_ GM_B_Current_DC : 0|32@1- (1,0) [-3.4E+038|3.4E+038] "A" Vector__XXX
 SG_ GM_B_Current_THD : 0|32@1- (1,0) [-3.4E+038|3.4E+038] "" Vector__XXX
 SG_ GM_B_Crest_Factor : 0|32@1- (1,0) [-3.4E+038|3.4E+038] "" Vector__XXX
 SG_ GM_B_Peak_Current : 0|32@1- (1,0) [-3.4E+038|3.4E+038] "A" Vector__XXX
 SG_ GM_B_Peak_Current_Recoded : 0|32@1- (1,0) [-3.4E+038|3.4E+038] "A" Vector__XXX
 SG_ GM_B_Active_Power : 0|32@1- (1,0) [-3.4E+038|3.4E+038] "kW" Vector__XXX
 SG_ GM_B_Power_Factor : 0|32@1- (1,0) [-3.4E+038|3.4E+038] "" Vector__XXX
 SG_ GM_B_Power_Factor_Angle : 0|32@1- (1,0) [-3.4E+038|3.4E+038] "Deg" Vector__XXX
 SG_ GM_B_Displacement_Factor : 0|32@1- (1,0) [-3.4E+038|3.4E+038] "" Vector__XXX
 SG_ GM_B_Distortion_Factor : 0|32@1- (1,0) [-3.4E+038|3.4E+038] "" Vector__XXX
 SG_ GM_B_Kilowatt_Hour : 0|32@1- (1,0) [-3.4E+038|3.4E+038] "kWh" Vector__XXX
 SG_ GM_B_KWH_Elapsed_Time : 0|32@1- (1,0) [-3.4E+038|3.4E+038] "s" Vector__XXX
 SG_ GM_C_Frequency : 0|32@1- (1,0) [-3.4E+038|3.4E+038] "Hz" Vector__XXX
 SG_ GM_C_Voltage_AC : 0|32@1- (1,0) [-3.4E+038|3.4E+038] "V" Vector__XXX
 SG_ GM_C_Voltage_ACDC : 0|32@1- (1,0) [-3.4E+038|3.4E+038] "V" Vector__XXX
 SG_ GM_C_Voltage_DC : 0|32@1- (1,0) [-3.4E+038|3.4E+038] "V" Vector__XXX
 SG_ GM_C_Voltage_THD : 0|32@1- (1,0) [-3.4E+038|3.4E+038] "" Vector__XXX
 SG_ GM_C_VoltageLL_AC : 0|32@1- (1,0) [-3.4E+038|3.4E+038] "V" Vector__XXX
 SG_ GM_C_VoltageLL_ACDC : 0|32@1- (1,0) [-3.4E+038|3.4E+038] "V" Vector__XXX
 SG_ GM_C_VoltageLL_DC : 0|32@1- (1,0) [-3.4E+038|3.4E+038] "V" Vector__XXX
 SG_ GM_C_Current_ACDC : 0|32@1- (1,0) [-3.4E+038|3.4E+038] "A" Vector__XXX
 SG_ GM_C_Current_DC : 0|32@1- (1,0) [-3.4E+038|3.4E+038] "A" Vector__XXX
 SG_ GM_C_Current_THD : 0|32@1- (1,0) [-3.4E+038|3.4E+038] "" Vector__XXX
 SG_ GM_C_Crest_Factor : 0|32@1- (1,0) [-3.4E+038|3.4E+038] "" Vector__XXX
 SG_ GM_C_Peak_Current : 0|32@1- (1,0) [-3.4E+038|3.4E+038] "A" Vector__XXX
 SG_ GM_C_Peak_Current_Recoded : 0|32@1- (1,0) [-3.4E+038|3.4E+038] "A" Vector__XXX
 SG_ GM_C_Active_Power : 0|32@1- (1,0) [-3.4E+038|3.4E+038] "kW" Vector__XXX
 SG_ GM_C_Power_Factor : 0|32@1- (1,0) [-3.4E+038|3.4E+038] "" Vector__XXX
 SG_ GM_C_Power_Factor_Angle : 0|32@1- (1,0) [-3.4E+038|3.4E+038] "Deg" Vector__XXX
 SG_ GM_C_Displacement_Factor : 0|32@1- (1,0) [-3.4E+038|3.4E+038] "" Vector__XXX
 SG_ GM_C_Distortion_Factor : 0|32@1- (1,0) [-3.4E+038|3.4E+038] "" Vector__XXX
 SG_ GM_C_Kilowatt_Hour : 0|32@1- (1,0) [-3.4E+038|3.4E+038] "kWh" Vector__XXX
 SG_ GM_C_KWH_Elapsed_Time : 0|32@1- (1,0) [-3.4E+038|3.4E+038] "s" Vector__XXX
 SG_ SP_ALL_Enable_Output : 0|8@1+ (1,0) [0|255] "" Vector__XXX
 SG_ SP_ALL_Frequency : 0|32@1- (1,0) [-3.4E+038|3.4E+038] "Hz" Vector__XXX
 SG_ SP_ALL_Phase : 0|32@1- (1,0) [-3.4E+038|3.4E+038] "Deg" Vector__XXX
 SG_ SP_ALL_Voltage_AC : 0|32@1- (1,0) [-3.4E+038|3.4E+038] "V" Vector__XXX
 SG_ SP_ALL_Voltage_DC : 0|32@1- (1,0) [-3.4E+038|3.4E+038] "V" Vector__XXX
 SG_ SP_ALL_Current_Limit : 0|32@1- (1,0) [-3.4E+038|3.4E+038] "A" Vector__XXX
 SG_ SP_ALL_KVA_Limit : 0|32@1- (1,0) [-3.4E+038|3.4E+038] "kVA" Vector__XXX
 SG_ SP_ALL_Power_Limit : 0|32@1- (1,0) [-3.4E+038|3.4E+038] "kW" Vector__XXX
 SG_ SP_A_Frequency : 0|32@1- (1,0) [-3.4E+038|3.4E+038] "Hz" Vector__XXX
 SG_ SP_A_Phase : 0|32@1- (1,0) [-3.4E+038|3.4E+038] "Deg" Vector__XXX
 SG_ SP_A_Voltage_AC : 0|32@1- (1,0) [-3.4E+038|3.4E+038] "V" Vector__XXX
 SG_ SP_A_Voltage_DC : 0|32@1- (1,0) [-3.4E+038|3.4E+038] "V" Vector__XXX
 SG_ SP_A_Current_Limit : 0|32@1- (1,0) [-3.4E+038|3.4E+038] "A" Vector__XXX
 SG_ SP_A_KVA_Limit : 0|32@1- (1,0) [-3.4E+038|3.4E+038] "kVA" Vector__XXX
 SG_ SP_A_Power_Limit : 0|32@1- (1,0) [-3.4E+038|3.4E+038] "kW" Vector__XXX
 SG_ SP_B_Frequency : 0|32@1- (1,0) [-3.4E+038|3.4E+038] "Hz" Vector__XXX
 SG_ SP_B_Phase : 0|32@1- (1,0) [-3.4E+038|3.4E+038] "Deg" Vector__XXX
 SG_ SP_B_Voltage_AC : 0|32@1- (1,0) [-3.4E+038|3.4E+038] "V" Vector__XXX
 SG_ SP_B_Voltage_DC : 0|32@1- (1,0) [-3.4E+038|3.4E+038] "V" Vector__XXX
 SG_ SP_B_Current_Limit : 0|32@1- (1,0) [-3.4E+038|3.4E+038] "A" Vector__XXX
 SG_ SP_B_KVA_Limit : 0|32@1- (1,0) [-3.4E+038|3.4E+038] "kVA" Vector__XXX
 SG_ SP_B_Power_Limit : 0|32@1- (1,0) [-3.4E+038|3.4E+038] "kW" Vector__XXX
 SG_ SP_C_Frequency : 0|32@1- (1,0) [-3.4E+038|3.4E+038] "Hz" Vector__XXX
 SG_ SP_C_Phase : 0|32@1- (1,0) [-3.4E+038|3.4E+038] "Deg" Vector__XXX
 SG_ SP_C_Voltage_AC : 0|32@1- (1,0) [-3.4E+038|3.4E+038] "V" Vector__XXX
 SG_ SP_C_Voltage_DC : 0|32@1- (1,0) [-3.4E+038|3.4E+038] "V" Vector__XXX
 SG_ SP_C_Current_Limit : 0|32@1- (1,0) [-3.4E+038|3.4E+038] "A" Vector__XXX
 SG_ SP_C_KVA_Limit : 0|32@1- (1,0) [-3.4E+038|3.4E+038] "kVA" Vector__XXX
 SG_ SP_C_Power_Limit : 0|32@1- (1,0) [-3.4E+038|3.4E+038] "kW" Vector__XXX
 SG_ GP_ALL_Enable_Output : 0|8@1+ (1,0) [0|255] "" Vector__XXX
 SG_ GP_ALL_Frequency : 0|32@1- (1,0) [-3.4E+038|3.4E+038] "Hz" Vector__XXX
 SG_ GP_ALL_Phase : 0|32@1- (1,0) [-3.4E+038|3.4E+038] "Deg" Vector__XXX
 SG_ GP_ALL_Voltage_AC : 0|32@1- (1,0) [-3.4E+038|3.4E+038] "V" Vector__XXX
 SG_ GP_ALL_Voltage_DC : 0|32@1- (1,0) [-3.4E+038|3.4E+038] "V" Vector__XXX
 SG_ GP_ALL_Current_Limit : 0|32@1- (1,0) [-3.4E+038|3.4E+038] "A" Vector__XXX
 SG_ GP_ALL_KVA_Limit : 0|32@1- (1,0) [-3.4E+038|3.4E+038] "kVA" Vector__XXX
 SG_ GP_ALL_Power_Limit : 0|32@1- (1,0) [-3.4E+038|3.4E+038] "kW" Vector__XXX
 SG_ GP_A_Frequency : 0|32@1- (1,0) [-3.4E+038|3.4E+038] "Hz" Vector__XXX
 SG_ GP_A_Phase : 0|32@1- (1,0) [-3.4E+038|3.4E+038] "Deg" Vector__XXX
 SG_ GP_A_Voltage_AC : 0|32@1- (1,0) [-3.4E+038|3.4E+038] "V" Vector__XXX
 SG_ GP_A_Voltage_DC : 0|32@1- (1,0) [-3.4E+038|3.4E+038] "V" Vector__XXX
 SG_ GP_A_Current_Limit : 0|32@1- (1,0) [-3.4E+038|3.4E+038] "A" Vector__XXX
 SG_ GP_A_KVA_Limit : 0|32@1- (1,0) [-3.4E+038|3.4E+038] "kVA" Vector__XXX
 SG_ GP_A_Power_Limit : 0|32@1- (1,0) [-3.4E+038|3.4E+038] "kW" Vector__XXX
 SG_ GP_B_Frequency : 0|32@1- (1,0) [-3.4E+038|3.4E+038] "Hz" Vector__XXX
 SG_ GP_B_Phase : 0|32@1- (1,0) [-3.4E+038|3.4E+038] "Deg" Vector__XXX
 SG_ GP_B_Voltage_AC : 0|32@1- (1,0) [-3.4E+038|3.4E+038] "V" Vector__XXX
 SG_ GP_B_Voltage_DC : 0|32@1- (1,0) [-3.4E+038|3.4E+038] "V" Vector__XXX
 SG_ GP_B_Current_Limit : 0|32@1- (1,0) [-3.4E+038|3.4E+038] "A" Vector__XXX
 SG_ GP_B_KVA_Limit : 0|32@1- (1,0) [-3.4E+038|3.4E+038] "kVA" Vector__XXX
 SG_ GP_B_Power_Limit : 0|32@1- (1,0) [-3.4E+038|3.4E+038] "kW" Vector__XXX
 SG_ GP_C_Frequency : 0|32@1- (1,0) [-3.4E+038|3.4E+038] "Hz" Vector__XXX
 SG_ GP_C_Phase : 0|32@1- (1,0) [-3.4E+038|3.4E+038] "Deg" Vector__XXX
 SG_ GP_C_Voltage_AC : 0|32@1- (1,0) [-3.4E+038|3.4E+038] "V" Vector__XXX
 SG_ GP_C_Voltage_DC : 0|32@1- (1,0) [-3.4E+038|3.4E+038] "V" Vector__XXX
 SG_ GP_C_Current_Limit : 0|32@1- (1,0) [-3.4E+038|3.4E+038] "A" Vector__XXX
 SG_ GP_C_KVA_Limit : 0|32@1- (1,0) [-3.4E+038|3.4E+038] "kVA" Vector__XXX
 SG_ GP_C_Power_Limit : 0|32@1- (1,0) [-3.4E+038|3.4E+038] "kW" Vector__XXX
 SG_ SPP_Peak_Current_Limit : 0|32@1- (1,0) [-3.4E+038|3.4E+038] "A" Vector__XXX
 SG_ SPP_Peak_Voltage_Enable : 0|8@1+ (1,0) [0|255] "" Vector__XXX
 SG_ SPP_Peak_Voltage_Mode : 0|8@1+ (1,0) [0|255] "" Vector__XXX
 SG_ SPP_Peak_Voltage_Level : 0|32@1- (1,0) [-3.4E+038|3.4E+038] "V" Vector__XXX
 SG_ SPP_Peak_Voltage_Margin : 0|32@1- (1,0) [-3.4E+038|3.4E+038] "V" Vector__XXX
 SG_ SPP_Peak_Current_Enable : 0|8@1+ (1,0) [0|255] "" Vector__XXX
 SG_ SPP_Peak_Current_Level : 0|32@1- (1,0) [-3.4E+038|3.4E+038] "A" Vector__XXX
 SG_ SPP_RMS_Current_Enable : 0|8@1+ (1,0) [0|255] "" Vector__XXX
 SG_ SPP_RMS_Current_Level : 0|32@1- (1,0) [-3.4E+038|3.4E+038] "A" Vector__XXX
 SG_ SPP_RMS_Power_Enable : 0|8@1+ (1,0) [0|255] "" Vector__XXX
 SG_ SPP_RMS_Power_Level : 0|32@1- (1,0) [-3.4E+038|3.4E+038] "kW" Vector__XXX
 SG_ SPP_RMS_KVA_Level : 0|32@1- (1,0) [-3.4E+038|3.4E+038] "kVA" Vector__XXX
 SG_ SPP_RMS_Trip_Time : 0|32@1- (1,0) [-3.4E+038|3.4E+038] "" Vector__XXX
 SG_ GPP_Peak_Current_Limit : 0|32@1- (1,0) [-3.4E+038|3.4E+038] "A" Vector__XXX
 SG_ GPP_Peak_Voltage_Enable : 0|8@1+ (1,0) [0|255] "" Vector__XXX
 SG_ GPP_Peak_Voltage_Mode : 0|8@1+ (1,0) [0|255] "" Vector__XXX
 SG_ GPP_Peak_Voltage_Level : 0|32@1- (1,0) [-3.4E+038|3.4E+038] "V" Vector__XXX
 SG_ GPP_Peak_Voltage_Margin : 0|32@1- (1,0) [-3.4E+038|3.4E+038] "V" Vector__XXX
 SG_ GPP_Peak_Current_Enable : 0|8@1+ (1,0) [0|255] "" Vector__XXX
 SG_ GPP_Peak_Current_Level : 0|32@1- (1,0) [-3.4E+038|3.4E+038] "A" Vector__XXX
 SG_ GPP_RMS_Current_Enable : 0|8@1+ (1,0) [0|255] "" Vector__XXX
 SG_ GPP_RMS_Current_Level : 0|32@1- (1,0) [-3.4E+038|3.4E+038] "A" Vector__XXX
 SG_ GPP_RMS_Power_Enable : 0|8@1+ (1,0) [0|255] "" Vector__XXX
 SG_ GPP_RMS_Power_Level : 0|32@1- (1,0) [-3.4E+038|3.4E+038] "kW" Vector__XXX
 SG_ GPP_RMS_KVA_Level : 0|32@1- (1,0) [-3.4E+038|3.4E+038] "kVA" Vector__XXX
 SG_ GPP_RMS_Trip_Time : 0|32@1- (1,0) [-3.4E+038|3.4E+038] "" Vector__XXX
 SG_ SC_Mode : 0|8@1+ (1,0) [0|255] "" Vector__XXX
 SG_ SC_Form : 0|8@1+ (1,0) [0|255] "" Vector__XXX
 SG_ SC_Range : 0|8@1+ (1,0) [0|255] "" Vector__XXX
 SG_ SC_Update_Phase : 0|32@1- (1,0) [-3.4E+038|3.4E+038] "Deg" Vector__XXX
 SG_ SC_Output_Disable_Phase : 0|32@1- (1,0) [-1|1080] "Deg" Vector__XXX
 SG_ SC_CSC_Fault_on_Saturation : 0|8@1+ (1,0) [0|255] "" Vector__XXX
 SG_ SC_CSC_Max_Gain : 0|32@1- (1,0) [-3.4E+038|3.4E+038] "" Vector__XXX
 SG_ SC_Phase_Rotation : 0|8@1+ (1,0) [0|255] "" Vector__XXX
 SG_ SC_Output_Impedance_Mode : 0|8@1+ (1,0) [0|255] "" Vector__XXX
 SG_ GC_Mode : 0|8@1+ (1,0) [0|255] "" Vector__XXX
 SG_ GC_Form : 0|8@1+ (1,0) [1|255] "" Vector__XXX
 SG_ GC_Range : 0|8@1+ (1,0) [0|255] "" Vector__XXX
 SG_ GC_Update_Phase : 0|32@1- (1,0) [-3.4E+038|3.4E+038] "Deg" Vector__XXX
 SG_ GC_Output_Disable_Phase : 0|32@1- (1,0) [-1|1080] "Deg" Vector__XXX
 SG_ GC_CSC_Enable : 0|8@1+ (1,0) [0|255] "" Vector__XXX
 SG_ GC_CSC_Fault_on_Saturation : 0|8@1+ (1,0) [0|255] "" Vector__XXX
 SG_ GC_CSC_Max_Gain : 0|32@1- (1,0) [-3.4E+038|3.4E+038] "" Vector__XXX
 SG_ GC_Phase_Rotation : 0|8@1+ (1,0) [0|255] "" Vector__XXX
 SG_ GC_Output_Impedance_Mode : 0|8@1+ (1,0) [0|255] "" Vector__XXX
 SG_ SC_Ramp_Time : 0|32@1- (1,0) [-0.0001|10000] "s" Vector__XXX
 SG_ SC_Slew_Frequency : 0|32@1- (1,0) [-3.4E+038|3.4E+038] "Hz/ms" Vector__XXX
 SG_ SC_Slew_Phase : 0|32@1- (1,0) [-3.4E+038|3.4E+038] "Deg/ms" Vector__XXX
 SG_ SC_Slew_Voltage_AC : 0|32@1- (1,0) [-3.4E+038|3.4E+038] "V/ms" Vector__XXX
 SG_ SC_Slew_Voltage_DC : 0|32@1- (1,0) [-3.4E+038|3.4E+038] "V/ms" Vector__XXX
 SG_ GC_Ramp_Time : 0|32@1- (1,0) [-0.0001|10000] "s" Vector__XXX
 SG_ GC_Slew_Frequency : 0|32@1- (1,0) [-3.4E+038|3.4E+038] "Hz/ms" Vector__XXX
 SG_ GC_Slew_Phase : 0|32@1- (1,0) [-3.4E+038|3.4E+038] "Deg/ms" Vector__XXX
 SG_ GC_Slew_Voltage_AC : 0|32@1- (1,0) [-3.4E+038|3.4E+038] "V/ms" Vector__XXX
 SG_ GC_Slew_Voltage_DC : 0|32@1- (1,0) [-3.4E+038|3.4E+038] "V/ms" Vector__XXX

BO_ 261 SCPI_Clear_Message: 1 Vector__XXX
 SG_ SCPI_Clear : 0|8@1+ (1,0) [0|255] ""  PPS_Device

BO_ 260 Firmware_Version_Message: 8 PPS_Device
 SG_ Firmware_Version : 0|64@1+ (1,0) [0|65535] ""  Client_PC,PPS_Device

BO_ 257 SCPI_Write_Message: 8 Client_PC
 SG_ SCPI_Write : 0|64@1+ (1,0) [0|1.84467440737096E+019] ""  PPS_Device

BO_ 258 SCPI_Read_Request_Message: 4 Client_PC
 SG_ SCPI_Read_Request : 0|16@1+ (1,0) [0|65535] ""  PPS_Device

BO_ 259 SCPI_Read_Response_Message: 8 PPS_Device
 SG_ SCPI_Read_Response : 0|64@1+ (1,0) [0|1.84467440737096E+019] ""  Client_PC

BO_ 256 Confirmation_Message: 8 PPS_Device
 SG_ ACK_CAN_ID : 32|32@1+ (1,0) [0|4294967295] ""  Client_PC,PPS_Device
 SG_ ACK_Signal : 0|32@1- (1,0) [-2147483648|2147483647] ""  PPS_Device,Client_PC

BO_TX_BU_ 260 : Client_PC,PPS_Device;

EV_ PPST: 0 [0|16] "" 5 1 DUMMY_NODE_VECTOR3 Vector__XXX;

CM_ BO_ 3221225472 "This is a message for not used signals, created by Vector CANdb++ DBC OLE DB Provider.";
CM_ SG_ 3221225472 SC_CSC_Enable "This signal sets the CSC (Continuous self calibration) setting value.
SCPI equivalent:
  SOURce:CSC";
CM_ SG_ 3221225472 SS_Faults_Reset "This signals resert Faults.
SCPI equivalent:
  STATus:FAULT:RESET";
CM_ SG_ 3221225472 GS_Fault "This signals returns if there are Faults present.
SCPI equivalent:
  STATus:FAULT?";
CM_ SG_ 3221225472 GS_Faults_Index "Signal to query fault in nodes 64 bits";
CM_ SG_ 3221225472 PM_ALL_Frequency "This signal periodically returns the measured frequency.
SCPI equivalent:
  MEASure:FREQuency?";
CM_ SG_ 3221225472 PM_ALL_Voltage_AC "This signal periodically returns the measured RMS voltage.
SCPI equivalent:
  MEASure:VOLTage:AC?";
CM_ SG_ 3221225472 PM_ALL_Voltage_ACDC "This signal periodically returns the measured RMS voltage.
SCPI equivalent:
  MEASure:VOLTage:ACDC?";
CM_ SG_ 3221225472 PM_ALL_Voltage_DC "This signal periodically returns the measured DC voltage.
SCPI equivalent:
  MEASure:VOLTage:DC?";
CM_ SG_ 3221225472 PM_ALL_Voltage_THD "This signal periodically returns the measured THD voltage.
SCPI equivalent:
  MEASure:VOLTage:ACDC1:THD?";
CM_ SG_ 3221225472 PM_ALL_VoltageLL_AC "This signal periodically returns the measured RMS Line-to-Line voltage.
SCPI equivalent:
  MEASure:VLL:AC?";
CM_ SG_ 3221225472 PM_ALL_VoltageLL_ACDC "This signal periodically returns the measured RMS Line-to-Line voltage.
SCPI equivalent:
  MEASure:VLL:ACDC?";
CM_ SG_ 3221225472 PM_ALL_VoltageLL_DC "This signal periodically returns the measured DC Line-to-Line voltage.
SCPI equivalent:
  MEASure:VLL:DC?";
CM_ SG_ 3221225472 PM_ALL_Current_ACDC "This signal periodically returns the measured RMS current.
SCPI equivalent:
  MEASure:CURRent:ACDC?";
CM_ SG_ 3221225472 PM_ALL_Current_DC "This signal periodically returns the measured DC current.
SCPI equivalent:
  MEASure:CURRent:DC?";
CM_ SG_ 3221225472 PM_ALL_Current_THD "This signal periodically returns the measured THD current.
SCPI equivalent:
  MEASure:CURRent:ACDC1:THD?";
CM_ SG_ 3221225472 PM_ALL_Crest_Factor "This signal periodically returns the measured current crest factor.
SCPI equivalent:
  MEASure:CURRent:CREST?";
CM_ SG_ 3221225472 PM_ALL_Peak_Current "This signal periodically returns the measured peak current.
SCPI equivalent:
  MEASure:CURRent:PEAK?";
CM_ SG_ 3221225472 PM_ALL_Peak_Current_Recoded "This signal periodically returns the recorded peak current.
SCPI equivalent:
  MEASure:CURRent:PEAK1:HOLD?";
CM_ SG_ 3221225472 PM_ALL_Active_Power "This signal periodically returns the measured true power in kW.
SCPI equivalent:
  MEASure:POWer?";
CM_ SG_ 3221225472 PM_ALL_Power_Factor "This signal periodically returns the measured power factor.
SCPI equivalent:
  MEASure:PF?";
CM_ SG_ 3221225472 PM_ALL_Power_Factor_Angle "This signal periodically returns the measured power factor angle.";
CM_ SG_ 3221225472 PM_ALL_Displacement_Factor "This signal periodically returns the measured displacement factor.
Is calculated from the measured of Power Factor:
  cos(Power_Factor * PI/180)";
CM_ SG_ 3221225472 PM_ALL_Distortion_Factor "This signal periodically returns the measured distortion factor.
Is calculated from the measured of power factor and displacement factor:
  Power_Factor/Displacement_Factor";
CM_ SG_ 3221225472 PM_ALL_Kilowatt_Hour "This signal periodically returns the accumulated energy measurement in kWh.
SCPI equivalent:
  MEASure:KWHour?";
CM_ SG_ 3221225472 PM_ALL_KWH_Elapsed_Time "This signal periodically returns the accumulated energy measurement time in seconds.
SCPI equivalent:
  MEASure:KWHour:ETIMe?";
CM_ SG_ 3221225472 PM_A_Frequency "This signal periodically returns the measured frequency for phase A.
SCPI equivalent:
  MEASure:FREQuency1?";
CM_ SG_ 3221225472 PM_A_Voltage_AC "This signal periodically returns the measured RMS voltage for phase A.
SCPI equivalent:
  MEASure:VOLTage:AC1?";
CM_ SG_ 3221225472 PM_A_Voltage_ACDC "This signal periodically returns the measured RMS voltage for phase A.
SCPI equivalent:
  MEASure:VOLTage:ACDC1?";
CM_ SG_ 3221225472 PM_A_Voltage_DC "This signal periodically returns the measured DC voltage for phase A.
SCPI equivalent:
  MEASure:VOLTage:DC1?";
CM_ SG_ 3221225472 PM_A_Voltage_THD "This signal periodically returns the measured THD voltage for phase A.
SCPI equivalent:
  MEASure:VOLTage:ACDC1:THD?";
CM_ SG_ 3221225472 PM_A_VoltageLL_AC "This signal periodically returns the measured RMS Line-to-Line voltage for phase A.
SCPI equivalent:
  MEASure:VLL:AC1?";
CM_ SG_ 3221225472 PM_A_VoltageLL_ACDC "This signal periodically returns the measured RMS Line-to-Line voltage for phase A.
SCPI equivalent:
  MEASure:VLL:ACDC1?";
CM_ SG_ 3221225472 PM_A_VoltageLL_DC "This signal periodically returns the measured DC Line-to-Line voltage for phase A.
SCPI equivalent:
  MEASure:VLL:DC1?";
CM_ SG_ 3221225472 PM_A_Current_ACDC "This signal periodically returns the measured RMS current for phase A.
SCPI equivalent:
  MEASure:CURRent:ACDC1?";
CM_ SG_ 3221225472 PM_A_Current_DC "This signal periodically returns the measured DC current for phase A.
SCPI equivalent:
  MEASure:CURRent:DC1?";
CM_ SG_ 3221225472 PM_A_Current_THD "This signal periodically returns the measured THD current for phase A.
SCPI equivalent:
  MEASure:CURRent:ACDC1:THD?";
CM_ SG_ 3221225472 PM_A_Crest_Factor "This signal periodically returns the measured current crest factor for phase A.
SCPI equivalent:
  MEASure:CURRent:CREST1?";
CM_ SG_ 3221225472 PM_A_Peak_Current "This signal periodically returns the measured peak current for phase A.
SCPI equivalent:
  MEASure:CURRent:PEAK1?";
CM_ SG_ 3221225472 PM_A_Peak_Current_Recoded "This signal periodically returns the recorded peak current for phase A.
SCPI equivalent:
  MEASure:CURRent:PEAK1:HOLD?";
CM_ SG_ 3221225472 PM_A_Active_Power "This signal periodically returns the measured true power for phase A in kW.
SCPI equivalent:
  MEASure:POWer1?";
CM_ SG_ 3221225472 PM_A_Power_Factor "This signal periodically returns the measured power factor for phase A.
SCPI equivalent:
  MEASure:PF1?";
CM_ SG_ 3221225472 PM_A_Power_Factor_Angle "This signal periodically returns the measured power factor angle for phase A.";
CM_ SG_ 3221225472 PM_A_Displacement_Factor "This signal periodically returns the measured displacement factor for phase A.
Is calculated from the measured of Power Factor:
  cos(Power_Factor * PI/180)";
CM_ SG_ 3221225472 PM_A_Distortion_Factor "This signal periodically returns the measured distortion factor for phase A.
Is calculated from the measured of power factor and displacement factor:
  Power_Factor/Displacement_Factor";
CM_ SG_ 3221225472 PM_A_Kilowatt_Hour "This signal periodically returns the accumulated energy measurement for phase A in kWh.
SCPI equivalent:
  MEASure:KWHour1?";
CM_ SG_ 3221225472 PM_A_KWH_Elapsed_Time "This signal periodically returns the accumulated energy measurement time in seconds.
SCPI equivalent:
  MEASure:KWHour:ETIMe?";
CM_ SG_ 3221225472 PM_B_Frequency "This signal periodically returns the measured frequency for phase B.
SCPI equivalent:
  MEASure:FREQuency2?";
CM_ SG_ 3221225472 PM_B_Voltage_AC "This signal periodically returns the measured RMS voltage for phase B.
SCPI equivalent:
  MEASure:VOLTage:AC2?";
CM_ SG_ 3221225472 PM_B_Voltage_ACDC "This signal periodically returns the measured RMS voltage for phase B.
SCPI equivalent:
  MEASure:VOLTage:ACDC2?";
CM_ SG_ 3221225472 PM_B_Voltage_DC "This signal periodically returns the measured DC voltage for phase B.
SCPI equivalent:
  MEASure:VOLTage:DC2?";
CM_ SG_ 3221225472 PM_B_Voltage_THD "This signal periodically returns the measured THD voltage for phase B.
SCPI equivalent:
  MEASure:VOLTage:ACDC1:THD?";
CM_ SG_ 3221225472 PM_B_VoltageLL_AC "This signal periodically returns the measured RMS Line-to-Line voltage for phase B.
SCPI equivalent:
  MEASure:VLL:AC2?";
CM_ SG_ 3221225472 PM_B_VoltageLL_ACDC "This signal periodically returns the measured RMS Line-to-Line voltage for phase B.
SCPI equivalent:
  MEASure:VLL:ACDC2?";
CM_ SG_ 3221225472 PM_B_VoltageLL_DC "This signal periodically returns the measured DC Line-to-Line voltage for phase B.
SCPI equivalent:
  MEASure:VLL:DC2?";
CM_ SG_ 3221225472 PM_B_Current_ACDC "This signal periodically returns the measured RMS current for phase B.
SCPI equivalent:
  MEASure:CURRent:ACDC2?";
CM_ SG_ 3221225472 PM_B_Current_DC "This signal periodically returns the measured DC current for phase B.
SCPI equivalent:
  MEASure:CURRent:DC2?";
CM_ SG_ 3221225472 PM_B_Current_THD "This signal periodically returns the measured THD current for phase B.
SCPI equivalent:
  MEASure:CURRent:ACDC1:THD?";
CM_ SG_ 3221225472 PM_B_Crest_Factor "This signal periodically returns the measured current crest factor for phase B.
SCPI equivalent:
  MEASure:CURRent:CREST2?";
CM_ SG_ 3221225472 PM_B_Peak_Current "This signal periodically returns the measured peak current for phase B.
SCPI equivalent:
  MEASure:CURRent:PEAK2?";
CM_ SG_ 3221225472 PM_B_Peak_Current_Recoded "This signal periodically returns the recorded peak current for phase B.
SCPI equivalent:
  MEASure:CURRent:PEAK1:HOLD?";
CM_ SG_ 3221225472 PM_B_Active_Power "This signal periodically returns the measured true power for phase B in kW.
SCPI equivalent:
  MEASure:POWer2?";
CM_ SG_ 3221225472 PM_B_Power_Factor "This signal periodically returns the measured power factor for phase B.
SCPI equivalent:
  MEASure:PF2?";
CM_ SG_ 3221225472 PM_B_Power_Factor_Angle "This signal periodically returns the measured power factor angle for phase B.";
CM_ SG_ 3221225472 PM_B_Displacement_Factor "This signal periodically returns the measured displacement factor for phase B.
Is calculated from the measured of Power Factor:
  cos(Power_Factor * PI/180)";
CM_ SG_ 3221225472 PM_B_Distortion_Factor "This signal periodically returns the measured distortion factor for phase B.
Is calculated from the measured of power factor and displacement factor:
  Power_Factor/Displacement_Factor";
CM_ SG_ 3221225472 PM_B_Kilowatt_Hour "This signal periodically returns the accumulated energy measurement for phase B in kWh.
SCPI equivalent:
  MEASure:KWHour2?";
CM_ SG_ 3221225472 PM_B_KWH_Elapsed_Time "This signal periodically returns the accumulated energy measurement time in seconds.
SCPI equivalent:
  MEASure:KWHour:ETIMe?";
CM_ SG_ 3221225472 PM_C_Frequency "This signal periodically returns the measured frequency for phase C.
SCPI equivalent:
  MEASure:FREQuency3?";
CM_ SG_ 3221225472 PM_C_Voltage_AC "This signal periodically returns the measured RMS voltage for phase C.
SCPI equivalent:
  MEASure:VOLTage:AC3?";
CM_ SG_ 3221225472 PM_C_Voltage_ACDC "This signal periodically returns the measured RMS voltage for phase C.
SCPI equivalent:
  MEASure:VOLTage:ACDC3?";
CM_ SG_ 3221225472 PM_C_Voltage_DC "This signal periodically returns the measured DC voltage for phase C.
SCPI equivalent:
  MEASure:VOLTage:DC3?";
CM_ SG_ 3221225472 PM_C_Voltage_THD "This signal periodically returns the measured THD voltage for phase C.
SCPI equivalent:
  MEASure:VOLTage:ACDC1:THD?";
CM_ SG_ 3221225472 PM_C_VoltageLL_AC "This signal periodically returns the measured RMS Line-to-Line voltage for phase C.
SCPI equivalent:
  MEASure:VLL:AC3?";
CM_ SG_ 3221225472 PM_C_VoltageLL_ACDC "This signal periodically returns the measured RMS Line-to-Line voltage for phase C.
SCPI equivalent:
  MEASure:VLL:ACDC3?";
CM_ SG_ 3221225472 PM_C_VoltageLL_DC "This signal periodically returns the measured DC Line-to-Line voltage for phase C.
SCPI equivalent:
  MEASure:VLL:DC3?";
CM_ SG_ 3221225472 PM_C_Current_ACDC "This signal periodically returns the measured RMS current for phase C.
SCPI equivalent:
  MEASure:CURRent:ACDC3?";
CM_ SG_ 3221225472 PM_C_Current_DC "This signal periodically returns the measured DC current for phase C.
SCPI equivalent:
  MEASure:CURRent:DC3?";
CM_ SG_ 3221225472 PM_C_Current_THD "This signal periodically returns the measured THD current for phase C.
SCPI equivalent:
  MEASure:CURRent:ACDC1:THD?";
CM_ SG_ 3221225472 PM_C_Crest_Factor "This signal periodically returns the measured current crest factor for phase C.
SCPI equivalent:
  MEASure:CURRent:CREST3?";
CM_ SG_ 3221225472 PM_C_Peak_Current "This signal periodically returns the measured peak current for phase C.
SCPI equivalent:
  MEASure:CURRent:PEAK3?";
CM_ SG_ 3221225472 PM_C_Peak_Current_Recoded "This signal periodically returns the recorded peak current for phase C.
SCPI equivalent:
  MEASure:CURRent:PEAK1:HOLD?";
CM_ SG_ 3221225472 PM_C_Active_Power "This signal periodically returns the measured true power for phase C in kW.
SCPI equivalent:
  MEASure:POWer3?";
CM_ SG_ 3221225472 PM_C_Power_Factor "This signal periodically returns the measured power factor for phase C.
SCPI equivalent:
  MEASure:PF3?";
CM_ SG_ 3221225472 PM_C_Power_Factor_Angle "This signal periodically returns the measured power factor angle for phase C.";
CM_ SG_ 3221225472 PM_C_Displacement_Factor "This signal periodically returns the measured displacement factor for phase C.
Is calculated from the measured of Power Factor:
  cos(Power_Factor * PI/180)";
CM_ SG_ 3221225472 PM_C_Distortion_Factor "This signal periodically returns the measured distortion factor for phase C.
Is calculated from the measured of power factor and displacement factor:
  Power_Factor/Displacement_Factor";
CM_ SG_ 3221225472 PM_C_Kilowatt_Hour "This signal periodically returns the accumulated energy measurement for phase C in kWh.
SCPI equivalent:
  MEASure:KWHour3?";
CM_ SG_ 3221225472 PM_C_KWH_Elapsed_Time "This signal periodically returns the accumulated energy measurement time in seconds.
SCPI equivalent:
  MEASure:KWHour:ETIMe?";
CM_ SG_ 3221225472 GM_ALL_Frequency "This signal returns the measured frequency.
SCPI equivalent:
  MEASure:FREQuency?";
CM_ SG_ 3221225472 GM_ALL_Voltage_AC "This signal returns the measured RMS voltage.
SCPI equivalent:
  MEASure:VOLTage:AC?";
CM_ SG_ 3221225472 GM_ALL_Voltage_ACDC "This signal returns the measured RMS voltage.
SCPI equivalent:
  MEASure:VOLTage:ACDC?";
CM_ SG_ 3221225472 GM_ALL_Voltage_DC "This signal returns the measured DC voltage.
SCPI equivalent:
  MEASure:VOLTage:DC?";
CM_ SG_ 3221225472 GM_ALL_Voltage_THD "This signal returns the measured THD voltage.
SCPI equivalent:
  MEASure:VOLTage:ACDC:THD?";
CM_ SG_ 3221225472 GM_ALL_VoltageLL_AC "This signal returns the measured RMS Line-to-Line voltage.
SCPI equivalent:
  MEASure:VLL:AC?";
CM_ SG_ 3221225472 GM_ALL_VoltageLL_ACDC "This signal returns the measured RMS Line-to-Line voltage.
SCPI equivalent:
  MEASure:VLL:ACDC?";
CM_ SG_ 3221225472 GM_ALL_VoltageLL_DC "This signal returns the measured DC Line-to-Line voltage.
SCPI equivalent:
  MEASure:VLL:DC?";
CM_ SG_ 3221225472 GM_ALL_Current_ACDC "This signal returns the measured RMS current.
SCPI equivalent:
  MEASure:CURRent:ACDC?";
CM_ SG_ 3221225472 GM_ALL_Current_DC "This signal returns the measured DC current.
SCPI equivalent:
  MEASure:CURRent:DC?";
CM_ SG_ 3221225472 GM_ALL_Current_THD "This signal returns the measured THD current.
SCPI equivalent:
  MEASure:CURRent:ACDC:THD?";
CM_ SG_ 3221225472 GM_ALL_Crest_Factor "This signal returns the measured current crest factor.
SCPI equivalent:
  MEASure:CURRent:CREST?";
CM_ SG_ 3221225472 GM_ALL_Peak_Current "This signal returns the measured peak current.
SCPI equivalent:
  MEASure:CURRent:PEAK?";
CM_ SG_ 3221225472 GM_ALL_Peak_Current_Recoded "This signal returns the recorded peak current.
SCPI equivalent:
  MEASure:CURRent:PEAK:HOLD?";
CM_ SG_ 3221225472 GM_ALL_Active_Power "This signal returns the true power in kW.
SCPI equivalent:
  MEASure:POWer?";
CM_ SG_ 3221225472 GM_ALL_Power_Factor "This signal returns the measured power factor.
SCPI equivalent:
  MEASure:PF?";
CM_ SG_ 3221225472 GM_ALL_Power_Factor_Angle "This signal returns the measured power factor angle.";
CM_ SG_ 3221225472 GM_ALL_Displacement_Factor "This signal returns the measured displacement factor.
Is calculated from the measured of Power Factor:
  cos(Power_Factor * PI/180)";
CM_ SG_ 3221225472 GM_ALL_Distortion_Factor "This signal returns the measured distortion factor.
Is calculated from the measured of power factor and displacement factor:
  Power_Factor/Displacement_Factor";
CM_ SG_ 3221225472 GM_ALL_Kilowatt_Hour "This signal returns the accumulated energy measurement for phase A in kWh.
SCPI equivalent:
  MEASure:KWHour?";
CM_ SG_ 3221225472 GM_ALL_KWH_Elapsed_Time "This signal returns the accumulated energy measurement time in seconds.
SCPI equivalent:
  MEASure:KWHour:ETIMe?";
CM_ SG_ 3221225472 GM_A_Frequency "This signal returns the measured frequency for phase A.
SCPI equivalent:
  MEASure:FREQuency1?";
CM_ SG_ 3221225472 GM_A_Voltage_AC "This signal returns the measured RMS voltage for phase A.
SCPI equivalent:
  MEASure:VOLTage:AC1?";
CM_ SG_ 3221225472 GM_A_Voltage_ACDC "This signal returns the measured RMS voltage for phase A.
SCPI equivalent:
  MEASure:VOLTage:ACDC1?";
CM_ SG_ 3221225472 GM_A_Voltage_DC "This signal returns the measured DC voltage for phase A.
SCPI equivalent:
  MEASure:VOLTage:DC1?";
CM_ SG_ 3221225472 GM_A_Voltage_THD "This signal returns the measured THD voltage for phase A.
SCPI equivalent:
  MEASure:VOLTage:ACDC1:THD?";
CM_ SG_ 3221225472 GM_A_VoltageLL_AC "This signal returns the measured RMS Line-to-Line voltage for phase A.
SCPI equivalent:
  MEASure:VLL:AC1?";
CM_ SG_ 3221225472 GM_A_VoltageLL_ACDC "This signal returns the measured RMS Line-to-Line voltage for phase A.
SCPI equivalent:
  MEASure:VLL:ACDC1?";
CM_ SG_ 3221225472 GM_A_VoltageLL_DC "This signal returns the measured DC Line-to-Line voltage for phase A.
SCPI equivalent:
  MEASure:VLL:DC1?";
CM_ SG_ 3221225472 GM_A_Current_ACDC "This signal returns the measured RMS current for phase A.
SCPI equivalent:
  MEASure:CURRent:ACDC1?";
CM_ SG_ 3221225472 GM_A_Current_DC "This signal returns the measured DC current for phase A.
SCPI equivalent:
  MEASure:CURRent:DC1?";
CM_ SG_ 3221225472 GM_A_Current_THD "This signal returns the measured THD current for phase A.
SCPI equivalent:
  MEASure:CURRent:ACDC1:THD?";
CM_ SG_ 3221225472 GM_A_Crest_Factor "This signal returns the measured current crest factor for phase A.
SCPI equivalent:
  MEASure:CURRent:CREST1?";
CM_ SG_ 3221225472 GM_A_Peak_Current "This signal returns the measured peak current for phase A.
SCPI equivalent:
  MEASure:CURRent:PEAK1?";
CM_ SG_ 3221225472 GM_A_Peak_Current_Recoded "This signal returns the recorded peak current for phase A.
SCPI equivalent:
  MEASure:CURRent:PEAK1:HOLD?";
CM_ SG_ 3221225472 GM_A_Active_Power "This signal returns the measured true power for phase A in kW.
SCPI equivalent:
  MEASure:POWer1?";
CM_ SG_ 3221225472 GM_A_Power_Factor "This signal returns the measured power factor for phase A.
SCPI equivalent:
  MEASure:PF1?";
CM_ SG_ 3221225472 GM_A_Power_Factor_Angle "This signal returns the measured power factor angle for phase A.";
CM_ SG_ 3221225472 GM_A_Displacement_Factor "This signal returns the measured displacement factor for phase A.
Is calculated from the measured of Power Factor:
  cos(Power_Factor * PI/180)";
CM_ SG_ 3221225472 GM_A_Distortion_Factor "This signal returns the measured distortion factor for phase A.
Is calculated from the measured of power factor and displacement factor:
  Power_Factor/Displacement_Factor";
CM_ SG_ 3221225472 GM_A_Kilowatt_Hour "This signal returns the accumulated energy measurement for phase A in kWh.
SCPI equivalent:
  MEASure:KWHour1?";
CM_ SG_ 3221225472 GM_A_KWH_Elapsed_Time "This signal returns the accumulated energy measurement time in seconds.
SCPI equivalent:
  MEASure:KWHour:ETIMe?";
CM_ SG_ 3221225472 GM_B_Frequency "This signal returns the measured frequency for phase B.
SCPI equivalent:
  MEASure:FREQuency2?";
CM_ SG_ 3221225472 GM_B_Voltage_AC "This signal returns the measured RMS voltage for phase B.
SCPI equivalent:
  MEASure:VOLTage:AC2?";
CM_ SG_ 3221225472 GM_B_Voltage_ACDC "This signal returns the measured RMS voltage for phase B.
SCPI equivalent:
  MEASure:VOLTage:ACDC2?";
CM_ SG_ 3221225472 GM_B_Voltage_DC "This signal returns the measured DC voltage for phase B.
SCPI equivalent:
  MEASure:VOLTage:DC2?";
CM_ SG_ 3221225472 GM_B_Voltage_THD "This signal returns the measured THD voltage for phase B.
SCPI equivalent:
  MEASure:VOLTage:ACDC2:THD?";
CM_ SG_ 3221225472 GM_B_VoltageLL_AC "This signal returns the measured RMS Line-to-Line voltage for phase B.
SCPI equivalent:
  MEASure:VLL:AC2?";
CM_ SG_ 3221225472 GM_B_VoltageLL_ACDC "This signal returns the measured RMS Line-to-Line voltage for phase B.
SCPI equivalent:
  MEASure:VLL:ACDC2?";
CM_ SG_ 3221225472 GM_B_VoltageLL_DC "This signal returns the measured DC Line-to-Line voltage for phase B.
SCPI equivalent:
  MEASure:VLL:DC2?";
CM_ SG_ 3221225472 GM_B_Current_ACDC "This signal returns the measured RMS current for phase B.
SCPI equivalent:
  MEASure:CURRent:ACDC2?";
CM_ SG_ 3221225472 GM_B_Current_DC "This signal returns the measured DC current for phase B.
SCPI equivalent:
  MEASure:CURRent:DC2?";
CM_ SG_ 3221225472 GM_B_Current_THD "This signal returns the measured THD current for phase B.
SCPI equivalent:
  MEASure:CURRent:ACDC2:THD?";
CM_ SG_ 3221225472 GM_B_Crest_Factor "This signal returns the measured current crest factor for phase B.
SCPI equivalent:
  MEASure:CURRent:CREST2?";
CM_ SG_ 3221225472 GM_B_Peak_Current "This signal returns the measured peak current for phase B.
SCPI equivalent:
  MEASure:CURRent:PEAK2?";
CM_ SG_ 3221225472 GM_B_Peak_Current_Recoded "This signal returns the recorded peak current for phase B.
SCPI equivalent:
  MEASure:CURRent:PEAK2:HOLD?";
CM_ SG_ 3221225472 GM_B_Active_Power "This signal returns the measured true power for phase B in kW.
SCPI equivalent:
  MEASure:POWer2?";
CM_ SG_ 3221225472 GM_B_Power_Factor "This signal returns the measured power factor for phase B.
SCPI equivalent:
  MEASure:PF2?";
CM_ SG_ 3221225472 GM_B_Power_Factor_Angle "This signal returns the measured power factor angle for phase B.";
CM_ SG_ 3221225472 GM_B_Displacement_Factor "This signal returns the measured displacement factor for phase B.
Is calculated from the measured of Power Factor:
  cos(Power_Factor * PI/180)";
CM_ SG_ 3221225472 GM_B_Distortion_Factor "This signal returns the measured distortion factor for phase B.
Is calculated from the measured of power factor and displacement factor:
  Power_Factor/Displacement_Factor";
CM_ SG_ 3221225472 GM_B_Kilowatt_Hour "This signal returns the accumulated energy measurement for phase B in kWh.
SCPI equivalent:
  MEASure:KWHour2?";
CM_ SG_ 3221225472 GM_B_KWH_Elapsed_Time "This signal returns the accumulated energy measurement time in seconds.
SCPI equivalent:
  MEASure:KWHour:ETIMe?";
CM_ SG_ 3221225472 GM_C_Frequency "This signal returns the measured frequency for phase C.
SCPI equivalent:
  MEASure:FREQuency3?";
CM_ SG_ 3221225472 GM_C_Voltage_AC "This signal returns the measured RMS voltage for phase C.
SCPI equivalent:
  MEASure:VOLTage:AC3?";
CM_ SG_ 3221225472 GM_C_Voltage_ACDC "This signal returns the measured RMS voltage for phase C.
SCPI equivalent:
  MEASure:VOLTage:ACDC3?";
CM_ SG_ 3221225472 GM_C_Voltage_DC "This signal returns the measured DC voltage for phase C.
SCPI equivalent:
  MEASure:VOLTage:DC3?";
CM_ SG_ 3221225472 GM_C_Voltage_THD "This signal returns the measured THD voltage for phase C.
SCPI equivalent:
  MEASure:VOLTage:ACDC3:THD?";
CM_ SG_ 3221225472 GM_C_VoltageLL_AC "This signal returns the measured RMS Line-to-Line voltage for phase C.
SCPI equivalent:
  MEASure:VLL:AC3?";
CM_ SG_ 3221225472 GM_C_VoltageLL_ACDC "This signal returns the measured RMS Line-to-Line voltage for phase C.
SCPI equivalent:
  MEASure:VLL:ACDC3?";
CM_ SG_ 3221225472 GM_C_VoltageLL_DC "This signal returns the measured RMS Line-to-Line voltage for phase C.
SCPI equivalent:
  MEASure:VLL:ACDC3?";
CM_ SG_ 3221225472 GM_C_Current_ACDC "This signal returns the measured RMS current for phase C.
SCPI equivalent:
  MEASure:CURRent:ACDC3?";
CM_ SG_ 3221225472 GM_C_Current_DC "This signal returns the measured DC current for phase C.
SCPI equivalent:
  MEASure:CURRent:DC3?";
CM_ SG_ 3221225472 GM_C_Current_THD "This signal returns the measured THD current for phase C.
SCPI equivalent:
  MEASure:CURRent:ACDC3:THD?";
CM_ SG_ 3221225472 GM_C_Crest_Factor "This signal returns the measured current crest factor for phase C.
SCPI equivalent:
  MEASure:CURRent:CREST3?";
CM_ SG_ 3221225472 GM_C_Peak_Current "This signal returns the measured peak current for phase C.
SCPI equivalent:
  MEASure:CURRent:PEAK3?";
CM_ SG_ 3221225472 GM_C_Peak_Current_Recoded "This signal returns the recorded peak current for phase C.
SCPI equivalent:
  MEASure:CURRent:PEAK3:HOLD?";
CM_ SG_ 3221225472 GM_C_Active_Power "This signal returns the measured true power for phase C in kW.
SCPI equivalent:
  MEASure:POWer3?";
CM_ SG_ 3221225472 GM_C_Power_Factor "This signal returns the measured power factor for phase C.
SCPI equivalent:
  MEASure:PF3?";
CM_ SG_ 3221225472 GM_C_Power_Factor_Angle "This signal returns the measured power factor angle for phase C.";
CM_ SG_ 3221225472 GM_C_Displacement_Factor "This signal returns the measured displacement factor for phase C.
Is calculated from the measured of Power Factor:
  cos(Power_Factor * PI/180)";
CM_ SG_ 3221225472 GM_C_Distortion_Factor "This signal returns the measured distortion factor for phase C.
Is calculated from the measured of power factor and displacement factor:
  Power_Factor/Displacement_Factor";
CM_ SG_ 3221225472 GM_C_Kilowatt_Hour "This signal returns the accumulated energy measurement for phase C in kWh.
SCPI equivalent:
  MEASure:KWHour3?";
CM_ SG_ 3221225472 GM_C_KWH_Elapsed_Time "This signal returns the accumulated energy measurement time in seconds.
SCPI equivalent:
  MEASure:KWHour:ETIMe?";
CM_ SG_ 3221225472 SP_ALL_Enable_Output "This signal Enables or Disables power output.
When enabled, all output relays are closed.
When disabled, all output relays are open.
SCPI equivalent:
  OUTPut:STATe";
CM_ SG_ 3221225472 SP_ALL_Frequency "This signal sets the output frequency for all phases.
SCPI equivalent:
  SOURce:FREQuency";
CM_ SG_ 3221225472 SP_ALL_Phase "This signal sets the phase angle for all phases.
SCPI equivalent:
  SOURce:PHASe";
CM_ SG_ 3221225472 SP_ALL_Voltage_AC "This signal sets AC voltage for all phases.
SCPI equivalent:
  SOURce:VOLTage:AC";
CM_ SG_ 3221225472 SP_ALL_Voltage_DC "This signal sets DC voltage for all phases.
SCPI equivalent:
  SOURce:VOLTage:DC";
CM_ SG_ 3221225472 SP_ALL_Current_Limit "This signal sets the programmable current level for all phases.
SCPI equivalent:
  SOURce:CURRent:LIMit";
CM_ SG_ 3221225472 SP_ALL_KVA_Limit "This signal sets the programmable apparent power limit in kVA for all phases.
SCPI equivalent:
  SOURce:KVA:LIMit";
CM_ SG_ 3221225472 SP_ALL_Power_Limit "This signal sets the programmable true power limit in kW for all phases.
SCPI equivalent:
  SOURce:POWer:LIMit";
CM_ SG_ 3221225472 SP_A_Frequency "This signal sets the output frequency for phase A.
SCPI equivalent:
  SOURce:FREQuency1";
CM_ SG_ 3221225472 SP_A_Phase "This signal sets the phase angle for phase A.
SCPI equivalent:
  SOURce:PHASe1";
CM_ SG_ 3221225472 SP_A_Voltage_AC "This signal sets AC voltage for phase A.
SCPI equivalent:
  SOURce:VOLTage:AC1";
CM_ SG_ 3221225472 SP_A_Voltage_DC "This signal sets DC voltage for phase A.
SCPI equivalent:
  SOURce:VOLTage:DC1";
CM_ SG_ 3221225472 SP_A_Current_Limit "This signal sets the programmable current level for phase A.
SCPI equivalent:
  SOURce:CURRent:LIMit1";
CM_ SG_ 3221225472 SP_A_KVA_Limit "This signal sets the programmable apparent power limit in kVA for phase A.
SCPI equivalent:
  SOURce:KVA:LIMit1";
CM_ SG_ 3221225472 SP_A_Power_Limit "This signal sets the programmable true power limit in kW for phase A.
SCPI equivalent:
  SOURce:POWer:LIMit1";
CM_ SG_ 3221225472 SP_B_Frequency "This signal sets the output frequency for phase B.
SCPI equivalent:
  SOURce:FREQuency2";
CM_ SG_ 3221225472 SP_B_Phase "This signal sets the phase angle for phase B.
SCPI equivalent:
  SOURce:PHASe2";
CM_ SG_ 3221225472 SP_B_Voltage_AC "This signal sets AC voltage for phase B.
SCPI equivalent:
  SOURce:VOLTage:AC2";
CM_ SG_ 3221225472 SP_B_Voltage_DC "This signal sets DC voltage for phase B.
SCPI equivalent:
  SOURce:VOLTage:DC2";
CM_ SG_ 3221225472 SP_B_Current_Limit "This signal sets the programmable current level for phase B.
SCPI equivalent:
  SOURce:CURRent:LIMit2";
CM_ SG_ 3221225472 SP_B_KVA_Limit "This signal sets the programmable apparent power limit in kVA for phase B.
SCPI equivalent:
  SOURce:KVA:LIMit2";
CM_ SG_ 3221225472 SP_B_Power_Limit "This signal sets the programmable true power limit in kW for phase B.
SCPI equivalent:
  SOURce:POWer:LIMit2";
CM_ SG_ 3221225472 SP_C_Frequency "This signal sets the output frequency for phase C.
SCPI equivalent:
  SOURce:FREQuency3";
CM_ SG_ 3221225472 SP_C_Phase "This signal sets the phase angle for phase C.
SCPI equivalent:
  SOURce:PHASe3";
CM_ SG_ 3221225472 SP_C_Voltage_AC "This signal sets AC voltage for phase C.
SCPI equivalent:
  SOURce:VOLTage:AC3";
CM_ SG_ 3221225472 SP_C_Voltage_DC "This signal sets DC voltage for phase C.
SCPI equivalent:
  SOURce:VOLTage:DC3";
CM_ SG_ 3221225472 SP_C_Current_Limit "This signal sets the programmable current level for phase C.
SCPI equivalent:
  SOURce:CURRent:LIMit3";
CM_ SG_ 3221225472 SP_C_KVA_Limit "This signal sets the programmable apparent power limit in kVA for phase C.
SCPI equivalent:
  SOURce:KVA:LIMit3";
CM_ SG_ 3221225472 SP_C_Power_Limit "This signal sets the programmable true power limit in kW for phase C.
SCPI equivalent:
  SOURce:POWer:LIMit3";
CM_ SG_ 3221225472 GP_ALL_Enable_Output "This signal returns power output state.
SCPI equivalent:
  OUTPut:STATe?";
CM_ SG_ 3221225472 GP_ALL_Frequency "This signal gets the output frequency sets for all phase.
SCPI equivalent:
  SOURce:FREQuency?";
CM_ SG_ 3221225472 GP_ALL_Phase "This signal gets the phase angle for all phase.
SCPI equivalent:
  SOURce:PHASe?";
CM_ SG_ 3221225472 GP_ALL_Voltage_AC "This signal returns the AC voltage setpoint for all phase.
SCPI equivalent:
  SOURce:VOLTage:AC?";
CM_ SG_ 3221225472 GP_ALL_Voltage_DC "This signal returns the DC voltage setpoint for all phase.
SCPI equivalent:
  SOURce:VOLTage:DC?";
CM_ SG_ 3221225472 GP_ALL_Current_Limit "This signal gets the programmable current level for all phase.
SCPI equivalent:
  SOURce:CURRent:LIMit?";
CM_ SG_ 3221225472 GP_ALL_KVA_Limit "This signal gets the programmable apparent power limit in kVA for all phase.
SCPI equivalent:
  SOURce:KVA:LIMit?";
CM_ SG_ 3221225472 GP_ALL_Power_Limit "This signal gets the programmable true power limit in kW for all phase.
SCPI equivalent:
  SOURce:POWer:LIMit?";
CM_ SG_ 3221225472 GP_A_Frequency "This signal gets the output frequency sets for phase A.
SCPI equivalent:
  SOURce:FREQuency1?";
CM_ SG_ 3221225472 GP_A_Phase "This signal gets the phase angle for phase A.
SCPI equivalent:
  SOURce:PHASe1?";
CM_ SG_ 3221225472 GP_A_Voltage_AC "This signal returns the AC voltage setpoint for phase A.
SCPI equivalent:
  SOURce:VOLTage:AC1?";
CM_ SG_ 3221225472 GP_A_Voltage_DC "This signal returns the DC voltage setpoint for phase A.
SCPI equivalent:
  SOURce:VOLTage:DC1?";
CM_ SG_ 3221225472 GP_A_Current_Limit "This signal gets the programmable current level for phase A.
SCPI equivalent:
  SOURce:CURRent:LIMit1?";
CM_ SG_ 3221225472 GP_A_KVA_Limit "This signal gets the programmable apparent power limit in kVA for phase A.
SCPI equivalent:
  SOURce:KVA:LIMit1?";
CM_ SG_ 3221225472 GP_A_Power_Limit "This signal gets the programmable true power limit in kW for phase A.
SCPI equivalent:
  SOURce:POWer:LIMit1?";
CM_ SG_ 3221225472 GP_B_Frequency "This signal gets the output frequency sets for phase B.
SCPI equivalent:
  SOURce:FREQuency2?";
CM_ SG_ 3221225472 GP_B_Phase "This signal gets the phase angle for phase B.
SCPI equivalent:
  SOURce:PHASe2?";
CM_ SG_ 3221225472 GP_B_Voltage_AC "This signal returns the AC voltage setpoint for phase B.
SCPI equivalent:
  SOURce:VOLTage:AC2?";
CM_ SG_ 3221225472 GP_B_Voltage_DC "This signal returns the DC voltage setpoint for phase B.
SCPI equivalent:
  SOURce:VOLTage:DC2?";
CM_ SG_ 3221225472 GP_B_Current_Limit "This signal gets the programmable current level for phase B.
SCPI equivalent:
  SOURce:CURRent:LIMit2?";
CM_ SG_ 3221225472 GP_B_KVA_Limit "This signal gets the programmable apparent power limit in kVA for phase B.
SCPI equivalent:
  SOURce:KVA:LIMit2?";
CM_ SG_ 3221225472 GP_B_Power_Limit "This signal gets the programmable true power limit in kW for phase B.
SCPI equivalent:
  SOURce:POWer:LIMit2?";
CM_ SG_ 3221225472 GP_C_Frequency "This signal gets the output frequency sets for phase C.
SCPI equivalent:
  SOURce:FREQuency3?";
CM_ SG_ 3221225472 GP_C_Phase "This signal gets the phase angle for phase C.
SCPI equivalent:
  SOURce:PHASe3?";
CM_ SG_ 3221225472 GP_C_Voltage_AC "This signal returns the AC voltage setpoint for phase C.
SCPI equivalent:
  SOURce:VOLTage:AC3?";
CM_ SG_ 3221225472 GP_C_Voltage_DC "This signal returns the DC voltage setpoint for phase C.
SCPI equivalent:
  SOURce:VOLTage:DC3?";
CM_ SG_ 3221225472 GP_C_Current_Limit "This signal gets the programmable current level for phase C.
SCPI equivalent:
  SOURce:CURRent:LIMit3?";
CM_ SG_ 3221225472 GP_C_KVA_Limit "This signal gets the programmable apparent power limit in kVA for phase C.
SCPI equivalent:
  SOURce:KVA:LIMit3?";
CM_ SG_ 3221225472 GP_C_Power_Limit "This signal gets the programmable true power limit in kW for phase C.
SCPI equivalent:
  SOURce:POWer:LIMit3?";
CM_ SG_ 3221225472 SPP_Peak_Current_Limit "This signal sets the programmable peak current limit.
SCPI equivalent:
  SOURce:PEAK:CURRent:LIMit";
CM_ SG_ 3221225472 SPP_Peak_Voltage_Enable "This signal sets the programmable peak voltage protection state.
SCPI equivalent:
  SOURce:PROTect:PEAK:VOLTage:STATe";
CM_ SG_ 3221225472 SPP_Peak_Voltage_Mode "This signal sets the programmable peak voltage protection mode.
SCPI equivalent:
  SOURce:PROTect:PEAK:VOLTage:MODE";
CM_ SG_ 3221225472 SPP_Peak_Voltage_Level "This signal sets the programmable peak voltage protection level.
SCPI equivalent:
  SOURce:PROTect:PEAK:VOLTage:LEVel";
CM_ SG_ 3221225472 SPP_Peak_Voltage_Margin "This signal sets the programmable peak voltage protection margin.
SCPI equivalent:
  SOURce:PROTect:PEAK:VOLTage:MARGin";
CM_ SG_ 3221225472 SPP_Peak_Current_Enable "This signal sets the programmable peak current protection state.
SCPI equivalent:
  SOURce:PROTect:PEAK:CURRent:STATe";
CM_ SG_ 3221225472 SPP_Peak_Current_Level "This signal sets the programmable peak current protection level.
SCPI equivalent:
  SOURce:PROTect:PEAK:CURRent:LEVel";
CM_ SG_ 3221225472 SPP_RMS_Current_Enable "This signal sets the programmable RMS current protection state.
SCPI equivalent:
  SOURce:PROTect:RMS:CURRent:STATe";
CM_ SG_ 3221225472 SPP_RMS_Current_Level "This signal sets the programmable RMS current protection level.
SCPI equivalent:
  SOURce:PROTect:RMS:CURRent:LEVel";
CM_ SG_ 3221225472 SPP_RMS_Power_Enable "This signal sets the programmable power protection state.
SCPI equivalent:
  SOURce:PROTect:RMS:POWer:STATe";
CM_ SG_ 3221225472 SPP_RMS_Power_Level "This signal sets the programmable true power protection level in kW.
SCPI equivalent:
  SOURce:PROTect:RMS:POWer:LEVel";
CM_ SG_ 3221225472 SPP_RMS_KVA_Level "This signal sets the programmable apparent power protection level in kVA.
SCPI equivalent:
  SOURce:PROTect:RMS:KVA:LEVel";
CM_ SG_ 3221225472 SPP_RMS_Trip_Time "This signal sets the programmable protection trip delay in 100 msecs increments, i.e. as setting of 5 means 500 msec.
SCPI equivalent:
  SOURce:PROTect:TDELAY";
CM_ SG_ 3221225472 GPP_Peak_Current_Limit "This signal gets the programmable peak current limit.
SCPI equivalent:
  SOURce:PEAK:CURRent:LIMit?";
CM_ SG_ 3221225472 GPP_Peak_Voltage_Enable "This signal gets the programmable peak voltage protection state.
SCPI equivalent:
  SOURce:PROTect:PEAK:VOLTage:STATe?";
CM_ SG_ 3221225472 GPP_Peak_Voltage_Mode "This signal gets the programmable peak voltage protection mode.
SCPI equivalent:
  SOURce:PROTect:PEAK:VOLTage:MODE?";
CM_ SG_ 3221225472 GPP_Peak_Voltage_Level "This signal gets the programmable peak voltage protection level.
SCPI equivalent:
  SOURce:PROTect:PEAK:VOLTage:LEVel?";
CM_ SG_ 3221225472 GPP_Peak_Voltage_Margin "This signal gets the programmable peak voltage protection margin.
SCPI equivalent:
  SOURce:PROTect:PEAK:VOLTage:MARGin?";
CM_ SG_ 3221225472 GPP_Peak_Current_Enable "This signal gets the programmable peak current protection state.
SCPI equivalent:
  SOURce:PROTect:PEAK:CURRent:STATe?";
CM_ SG_ 3221225472 GPP_Peak_Current_Level "This signal gets the programmable peak current protection level.
SCPI equivalent:
  SOURce:PROTect:PEAK:CURRent:LEVel?";
CM_ SG_ 3221225472 GPP_RMS_Current_Enable "This signal gets the programmable RMS current protection state.
SCPI equivalent:
  SOURce:PROTect:RMS:CURRent:STATe?";
CM_ SG_ 3221225472 GPP_RMS_Current_Level "This signal gets the programmable RMS current protection level.
SCPI equivalent:
  SOURce:PROTect:RMS:CURRent:LEVel?";
CM_ SG_ 3221225472 GPP_RMS_Power_Enable "This signal gets the programmable power protection state.
SCPI equivalent:
  SOURce:PROTect:RMS:POWer:STATe?";
CM_ SG_ 3221225472 GPP_RMS_Power_Level "This signal gets the programmable true power protection level in kW.
SCPI equivalent:
  SOURce:PROTect:RMS:POWer:LEVel?";
CM_ SG_ 3221225472 GPP_RMS_KVA_Level "This signal gets the programmable apparent power protection level in kVA.
SCPI equivalent:
  SOURce:PROTect:RMS:KVA:LEVel?";
CM_ SG_ 3221225472 GPP_RMS_Trip_Time "This signal gets the programmable protection trip delay. Delay value  in 100 msecs increments, i.e. as setting of 5 means 500 msec.
SCPI equivalent:
  SOURce:PROTect:TDELAY?";
CM_ SG_ 3221225472 SC_Mode "This signal sets the Voltage Mode setting value.
SCPI equivalent:
  SOURce:VOLTage:MODE";
CM_ SG_ 3221225472 SC_Form "This signal sets the Form setting value.
SCPI equivalent:
  SOURce:FORM";
CM_ SG_ 3221225472 SC_Range "This signal sets the Range setting value.
SCPI equivalent:
  SOURce:RANGe";
CM_ SG_ 3221225472 SC_Update_Phase "This signal sets the Update Phase setting value.
SCPI equivalent:
  SOURce:UPDATEPHase";
CM_ SG_ 3221225472 SC_Output_Disable_Phase "This signal sets the Output Disable Phase setting value.
SCPI equivalent:
  OUTPut:DISABLEPHase";
CM_ SG_ 3221225472 SC_CSC_Fault_on_Saturation "This signal sets thet CSC (Continuous self calibration)  fault on saturation setting value.
SCPI equivalent:
  SOURce:CSC:SATuratefault";
CM_ SG_ 3221225472 SC_CSC_Max_Gain "This signal sets the Maximum CSC gain setting value.
SCPI equivalent:
  SOURce:CSC:MAXgain";
CM_ SG_ 3221225472 SC_Phase_Rotation "This signal queries the Phase Rotation setting value.
SCPI equivalent:
  SOURce:PHASe:ROTation";
CM_ SG_ 3221225472 SC_Output_Impedance_Mode "This signal sets the Output Impedance Mode setting value.
SCPI equivalent:
  SOURce:IMPEDance:MODE";
CM_ SG_ 3221225472 GC_Mode "This signal queries the Voltage Mode setting value.
SCPI equivalent:
  SOURce:VOLTage:MODE?";
CM_ SG_ 3221225472 GC_Form "This signal queries the Form setting value.
SCPI equivalent:
   SOURce:FORM?";
CM_ SG_ 3221225472 GC_Range "This signal queries the Range setting value.
SCPI equivalent:
  SOURce:RANGe?";
CM_ SG_ 3221225472 GC_Update_Phase "This signal queries the Update Phase setting value.
SCPI equivalent:
  SOURce:UPDATEPHase?";
CM_ SG_ 3221225472 GC_Output_Disable_Phase "This signal queries the Output Disable Phase setting value.
SCPI equivalent:
  OUTPut:DISABLEPHase?";
CM_ SG_ 3221225472 GC_CSC_Enable "This signal queries the CSC (Continuous self calibration) setting value.
SCPI equivalent:
  SOURce:CSC?";
CM_ SG_ 3221225472 GC_CSC_Fault_on_Saturation "This signal queries thet CSC (Continuous self calibration)  fault on saturation setting value.
SCPI equivalent:
  SOURce:CSC:SATuratefault?";
CM_ SG_ 3221225472 GC_CSC_Max_Gain "This signal queries the Maximum CSC gain setting value.
SCPI equivalent:
  SOURce:CSC:MAXgain?";
CM_ SG_ 3221225472 GC_Phase_Rotation "This signal queries the Phase Rotation setting value.
SCPI equivalent:
  SOURce:PHASe:ROTation?";
CM_ SG_ 3221225472 GC_Output_Impedance_Mode "This signal queries the Output Impedance Mode setting value.
SCPI equivalent:
  SOURce:IMPEDance:MODE?";
CM_ SG_ 3221225472 SC_Ramp_Time "This signal queries the Ramp Time setting value.
SCPI equivalent:
  SOURce:RAMP";
CM_ SG_ 3221225472 SC_Slew_Frequency "This signal sets the Frequency Slew Rate setting value.
SCPI equivalent:
  SOURce:FREQuency:SLEW";
CM_ SG_ 3221225472 SC_Slew_Phase "This signal sets the Phase Slew Rate setting value.
SCPI equivalent:
  SOURce:PHASe:SLEW";
CM_ SG_ 3221225472 SC_Slew_Voltage_AC "This signal sets the Voltage AC Slew Rate setting value.
SCPI equivalent:
  SOURce:VOLTage:AC:SLEW";
CM_ SG_ 3221225472 SC_Slew_Voltage_DC "This signal sets the Voltage DC Slew Rate setting value.
SCPI equivalent:
  SOURce:VOLTage:DC:SLEW";
CM_ SG_ 3221225472 GC_Ramp_Time "This signal queries the Ramp Time setting value.
SCPI equivalent:
  SOURce:RAMP?";
CM_ SG_ 3221225472 GC_Slew_Frequency "This signal queries the Frequency Slew Rate setting value.
SCPI equivalent:
  SOURce:FREQuency:SLEW?";
CM_ SG_ 3221225472 GC_Slew_Phase "This signal queries the Phase Slew Rate setting value.
SCPI equivalent:
  SOURce:PHASe:SLEW?";
CM_ SG_ 3221225472 GC_Slew_Voltage_AC "This signal queries the Voltage AC Slew Rate setting value.
SCPI equivalent:
  SOURce:VOLTage:AC:SLEW?";
CM_ SG_ 3221225472 GC_Slew_Voltage_DC "This signal queries the Voltage DC Slew Rate setting value.
SCPI equivalent:
  SOURce:VOLTage:DC:SLEW?";
CM_ SG_ 261 SCPI_Clear "This signal can be used to clear the SCPI write and read buffer.";
CM_ SG_ 260 Firmware_Version "This signal queries the Firmware version.
SCPI equivalent:
  SYSTem:FW:FRONTPANEL:VERsion?";
CM_ SG_ 257 SCPI_Write "This signal can be used to write a SCPI command string.";
CM_ SG_ 258 SCPI_Read_Request "This signal request a string chunk of the SCPI response, sending a value as index for the read buffer.";
CM_ SG_ 259 SCPI_Read_Response "This signal response a string chunk of the SCPI response if there are any.";
CM_ SG_ 256 ACK_CAN_ID "Acknowledge CAN Id.";
CM_ SG_ 256 ACK_Signal "Acknowledge signal";
BA_DEF_ BO_  "CANFD_BRS" ENUM  "0","1";
BA_DEF_  "DBName" STRING ;
BA_DEF_  "BusType" STRING ;
BA_DEF_ BO_  "VFrameFormat" ENUM  "StandardCAN","ExtendedCAN","reserved","reserved","reserved","reserved","reserved","reserved","reserved","reserved","reserved","reserved","reserved","reserved","StandardCAN_FD","ExtendedCAN_FD";
BA_DEF_ EV_  "Mode" ENUM  "CAN (SJA1000)","CAN","ISO CAN FD","Non-ISO CAN FD";
BA_DEF_ EV_  "Data_Bit_Rate" INT 1000000 10000000;
BA_DEF_ EV_  "Nominal_Bit_Rate" INT 5000 1000000;
BA_DEF_DEF_  "CANFD_BRS" "1";
BA_DEF_DEF_  "DBName" "";
BA_DEF_DEF_  "BusType" "";
BA_DEF_DEF_  "VFrameFormat" "StandardCAN";
BA_DEF_DEF_  "Mode" "CAN (SJA1000)";
BA_DEF_DEF_  "Data_Bit_Rate" 2000000;
BA_DEF_DEF_  "Nominal_Bit_Rate" 1000000;
BA_ "BusType" "CAN FD";
BA_ "DBName" "PPST";
VAL_ 3221225472 SC_CSC_Enable 1 "Enabled" 0 "Disabled" ;
VAL_ 3221225472 GS_Fault 1 "Faults_present" 0 "No_faults_present" ;
VAL_ 3221225472 SP_ALL_Enable_Output 1 "Enabled" 0 "Disabled" ;
VAL_ 3221225472 GP_ALL_Enable_Output 1 "Enabled" 0 "Disabled" ;
VAL_ 3221225472 SPP_Peak_Voltage_Enable 1 "Enabled" 0 "Disabled" ;
VAL_ 3221225472 SPP_Peak_Voltage_Mode 2 "Margin_and_level" 1 "Level" 0 "Margin" ;
VAL_ 3221225472 SPP_Peak_Current_Enable 1 "Enabled" 0 "Disabled" ;
VAL_ 3221225472 SPP_RMS_Current_Enable 1 "Enabled" 0 "Disabled" ;
VAL_ 3221225472 SPP_RMS_Power_Enable 1 "Enabled" 0 "Disabled" ;
VAL_ 3221225472 GPP_Peak_Voltage_Enable 1 "Enabled" 0 "Disabled" ;
VAL_ 3221225472 GPP_Peak_Voltage_Mode 2 "Margin_and_level" 1 "Level" 0 "Margin" ;
VAL_ 3221225472 GPP_Peak_Current_Enable 1 "Enabled" 0 "Disabled" ;
VAL_ 3221225472 GPP_RMS_Current_Enable 1 "Enabled" 0 "Disabled" ;
VAL_ 3221225472 GPP_RMS_Power_Enable 1 "Enabled" 0 "Disabled" ;
VAL_ 3221225472 SC_Mode 2 "AC_DC_mode" 1 "DC_mode" 0 "AC_mode" ;
VAL_ 3221225472 SC_Form 6 "Split_plus_one_output" 5 "Three_outputs" 4 "Two_outputs" 3 "Three" 2 "Split" 1 "Single" ;
VAL_ 3221225472 SC_Range 1 "High_range" 0 "Low_range" ;
VAL_ 3221225472 SC_CSC_Fault_on_Saturation 1 "Enabled" 0 "Disabled" ;
VAL_ 3221225472 SC_Phase_Rotation 1 "Positive" 0 "Negative" ;
VAL_ 3221225472 SC_Output_Impedance_Mode 1 "RMS" 0 "Real_time" ;
VAL_ 3221225472 GC_Mode 2 "AC_DC_mode" 1 "DC_mode" 0 "AC_mode" ;
VAL_ 3221225472 GC_Form 6 "Split_plus_one_output" 5 "Three_outputs" 4 "Two_outputs" 3 "Three" 2 "Split" 1 "Single" ;
VAL_ 3221225472 GC_Range 1 "High_range" 0 "Low_range" ;
VAL_ 3221225472 GC_CSC_Enable 1 "Enabled" 0 "Disabled" ;
VAL_ 3221225472 GC_CSC_Fault_on_Saturation 1 "Enabled" 0 "Disabled" ;
VAL_ 3221225472 GC_Phase_Rotation 1 "Positive" 0 "Negative" ;
VAL_ 3221225472 GC_Output_Impedance_Mode 1 "RMS" 0 "Real_time" ;
SIG_VALTYPE_ 3221225472 PM_ALL_Frequency : 1;
SIG_VALTYPE_ 3221225472 PM_ALL_Voltage_AC : 1;
SIG_VALTYPE_ 3221225472 PM_ALL_Voltage_ACDC : 1;
SIG_VALTYPE_ 3221225472 PM_ALL_Voltage_DC : 1;
SIG_VALTYPE_ 3221225472 PM_ALL_Voltage_THD : 1;
SIG_VALTYPE_ 3221225472 PM_ALL_VoltageLL_AC : 1;
SIG_VALTYPE_ 3221225472 PM_ALL_VoltageLL_ACDC : 1;
SIG_VALTYPE_ 3221225472 PM_ALL_VoltageLL_DC : 1;
SIG_VALTYPE_ 3221225472 PM_ALL_Current_ACDC : 1;
SIG_VALTYPE_ 3221225472 PM_ALL_Current_DC : 1;
SIG_VALTYPE_ 3221225472 PM_ALL_Current_THD : 1;
SIG_VALTYPE_ 3221225472 PM_ALL_Crest_Factor : 1;
SIG_VALTYPE_ 3221225472 PM_ALL_Peak_Current : 1;
SIG_VALTYPE_ 3221225472 PM_ALL_Peak_Current_Recoded : 1;
SIG_VALTYPE_ 3221225472 PM_ALL_Active_Power : 1;
SIG_VALTYPE_ 3221225472 PM_ALL_Power_Factor : 1;
SIG_VALTYPE_ 3221225472 PM_ALL_Power_Factor_Angle : 1;
SIG_VALTYPE_ 3221225472 PM_ALL_Displacement_Factor : 1;
SIG_VALTYPE_ 3221225472 PM_ALL_Distortion_Factor : 1;
SIG_VALTYPE_ 3221225472 PM_ALL_Kilowatt_Hour : 1;
SIG_VALTYPE_ 3221225472 PM_ALL_KWH_Elapsed_Time : 1;
SIG_VALTYPE_ 3221225472 PM_A_Frequency : 1;
SIG_VALTYPE_ 3221225472 PM_A_Voltage_AC : 1;
SIG_VALTYPE_ 3221225472 PM_A_Voltage_ACDC : 1;
SIG_VALTYPE_ 3221225472 PM_A_Voltage_DC : 1;
SIG_VALTYPE_ 3221225472 PM_A_Voltage_THD : 1;
SIG_VALTYPE_ 3221225472 PM_A_VoltageLL_AC : 1;
SIG_VALTYPE_ 3221225472 PM_A_VoltageLL_ACDC : 1;
SIG_VALTYPE_ 3221225472 PM_A_VoltageLL_DC : 1;
SIG_VALTYPE_ 3221225472 PM_A_Current_ACDC : 1;
SIG_VALTYPE_ 3221225472 PM_A_Current_DC : 1;
SIG_VALTYPE_ 3221225472 PM_A_Current_THD : 1;
SIG_VALTYPE_ 3221225472 PM_A_Crest_Factor : 1;
SIG_VALTYPE_ 3221225472 PM_A_Peak_Current : 1;
SIG_VALTYPE_ 3221225472 PM_A_Peak_Current_Recoded : 1;
SIG_VALTYPE_ 3221225472 PM_A_Active_Power : 1;
SIG_VALTYPE_ 3221225472 PM_A_Power_Factor : 1;
SIG_VALTYPE_ 3221225472 PM_A_Power_Factor_Angle : 1;
SIG_VALTYPE_ 3221225472 PM_A_Displacement_Factor : 1;
SIG_VALTYPE_ 3221225472 PM_A_Distortion_Factor : 1;
SIG_VALTYPE_ 3221225472 PM_A_Kilowatt_Hour : 1;
SIG_VALTYPE_ 3221225472 PM_A_KWH_Elapsed_Time : 1;
SIG_VALTYPE_ 3221225472 PM_B_Frequency : 1;
SIG_VALTYPE_ 3221225472 PM_B_Voltage_AC : 1;
SIG_VALTYPE_ 3221225472 PM_B_Voltage_ACDC : 1;
SIG_VALTYPE_ 3221225472 PM_B_Voltage_DC : 1;
SIG_VALTYPE_ 3221225472 PM_B_Voltage_THD : 1;
SIG_VALTYPE_ 3221225472 PM_B_VoltageLL_AC : 1;
SIG_VALTYPE_ 3221225472 PM_B_VoltageLL_ACDC : 1;
SIG_VALTYPE_ 3221225472 PM_B_VoltageLL_DC : 1;
SIG_VALTYPE_ 3221225472 PM_B_Current_ACDC : 1;
SIG_VALTYPE_ 3221225472 PM_B_Current_DC : 1;
SIG_VALTYPE_ 3221225472 PM_B_Current_THD : 1;
SIG_VALTYPE_ 3221225472 PM_B_Crest_Factor : 1;
SIG_VALTYPE_ 3221225472 PM_B_Peak_Current : 1;
SIG_VALTYPE_ 3221225472 PM_B_Peak_Current_Recoded : 1;
SIG_VALTYPE_ 3221225472 PM_B_Active_Power : 1;
SIG_VALTYPE_ 3221225472 PM_B_Power_Factor : 1;
SIG_VALTYPE_ 3221225472 PM_B_Power_Factor_Angle : 1;
SIG_VALTYPE_ 3221225472 PM_B_Displacement_Factor : 1;
SIG_VALTYPE_ 3221225472 PM_B_Distortion_Factor : 1;
SIG_VALTYPE_ 3221225472 PM_B_Kilowatt_Hour : 1;
SIG_VALTYPE_ 3221225472 PM_B_KWH_Elapsed_Time : 1;
SIG_VALTYPE_ 3221225472 PM_C_Frequency : 1;
SIG_VALTYPE_ 3221225472 PM_C_Voltage_AC : 1;
SIG_VALTYPE_ 3221225472 PM_C_Voltage_ACDC : 1;
SIG_VALTYPE_ 3221225472 PM_C_Voltage_DC : 1;
SIG_VALTYPE_ 3221225472 PM_C_Voltage_THD : 1;
SIG_VALTYPE_ 3221225472 PM_C_VoltageLL_AC : 1;
SIG_VALTYPE_ 3221225472 PM_C_VoltageLL_ACDC : 1;
SIG_VALTYPE_ 3221225472 PM_C_VoltageLL_DC : 1;
SIG_VALTYPE_ 3221225472 PM_C_Current_ACDC : 1;
SIG_VALTYPE_ 3221225472 PM_C_Current_DC : 1;
SIG_VALTYPE_ 3221225472 PM_C_Current_THD : 1;
SIG_VALTYPE_ 3221225472 PM_C_Crest_Factor : 1;
SIG_VALTYPE_ 3221225472 PM_C_Peak_Current : 1;
SIG_VALTYPE_ 3221225472 PM_C_Peak_Current_Recoded : 1;
SIG_VALTYPE_ 3221225472 PM_C_Active_Power : 1;
SIG_VALTYPE_ 3221225472 PM_C_Power_Factor : 1;
SIG_VALTYPE_ 3221225472 PM_C_Power_Factor_Angle : 1;
SIG_VALTYPE_ 3221225472 PM_C_Displacement_Factor : 1;
SIG_VALTYPE_ 3221225472 PM_C_Distortion_Factor : 1;
SIG_VALTYPE_ 3221225472 PM_C_Kilowatt_Hour : 1;
SIG_VALTYPE_ 3221225472 PM_C_KWH_Elapsed_Time : 1;
SIG_VALTYPE_ 3221225472 GM_ALL_Frequency : 1;
SIG_VALTYPE_ 3221225472 GM_ALL_Voltage_AC : 1;
SIG_VALTYPE_ 3221225472 GM_ALL_Voltage_ACDC : 1;
SIG_VALTYPE_ 3221225472 GM_ALL_Voltage_DC : 1;
SIG_VALTYPE_ 3221225472 GM_ALL_Voltage_THD : 1;
SIG_VALTYPE_ 3221225472 GM_ALL_VoltageLL_AC : 1;
SIG_VALTYPE_ 3221225472 GM_ALL_VoltageLL_ACDC : 1;
SIG_VALTYPE_ 3221225472 GM_ALL_VoltageLL_DC : 1;
SIG_VALTYPE_ 3221225472 GM_ALL_Current_ACDC : 1;
SIG_VALTYPE_ 3221225472 GM_ALL_Current_DC : 1;
SIG_VALTYPE_ 3221225472 GM_ALL_Current_THD : 1;
SIG_VALTYPE_ 3221225472 GM_ALL_Crest_Factor : 1;
SIG_VALTYPE_ 3221225472 GM_ALL_Peak_Current : 1;
SIG_VALTYPE_ 3221225472 GM_ALL_Peak_Current_Recoded : 1;
SIG_VALTYPE_ 3221225472 GM_ALL_Active_Power : 1;
SIG_VALTYPE_ 3221225472 GM_ALL_Power_Factor : 1;
SIG_VALTYPE_ 3221225472 GM_ALL_Power_Factor_Angle : 1;
SIG_VALTYPE_ 3221225472 GM_ALL_Displacement_Factor : 1;
SIG_VALTYPE_ 3221225472 GM_ALL_Distortion_Factor : 1;
SIG_VALTYPE_ 3221225472 GM_ALL_Kilowatt_Hour : 1;
SIG_VALTYPE_ 3221225472 GM_ALL_KWH_Elapsed_Time : 1;
SIG_VALTYPE_ 3221225472 GM_A_Frequency : 1;
SIG_VALTYPE_ 3221225472 GM_A_Voltage_AC : 1;
SIG_VALTYPE_ 3221225472 GM_A_Voltage_ACDC : 1;
SIG_VALTYPE_ 3221225472 GM_A_Voltage_DC : 1;
SIG_VALTYPE_ 3221225472 GM_A_Voltage_THD : 1;
SIG_VALTYPE_ 3221225472 GM_A_VoltageLL_AC : 1;
SIG_VALTYPE_ 3221225472 GM_A_VoltageLL_ACDC : 1;
SIG_VALTYPE_ 3221225472 GM_A_VoltageLL_DC : 1;
SIG_VALTYPE_ 3221225472 GM_A_Current_ACDC : 1;
SIG_VALTYPE_ 3221225472 GM_A_Current_DC : 1;
SIG_VALTYPE_ 3221225472 GM_A_Current_THD : 1;
SIG_VALTYPE_ 3221225472 GM_A_Crest_Factor : 1;
SIG_VALTYPE_ 3221225472 GM_A_Peak_Current : 1;
SIG_VALTYPE_ 3221225472 GM_A_Peak_Current_Recoded : 1;
SIG_VALTYPE_ 3221225472 GM_A_Active_Power : 1;
SIG_VALTYPE_ 3221225472 GM_A_Power_Factor : 1;
SIG_VALTYPE_ 3221225472 GM_A_Power_Factor_Angle : 1;
SIG_VALTYPE_ 3221225472 GM_A_Displacement_Factor : 1;
SIG_VALTYPE_ 3221225472 GM_A_Distortion_Factor : 1;
SIG_VALTYPE_ 3221225472 GM_A_Kilowatt_Hour : 1;
SIG_VALTYPE_ 3221225472 GM_A_KWH_Elapsed_Time : 1;
SIG_VALTYPE_ 3221225472 GM_B_Frequency : 1;
SIG_VALTYPE_ 3221225472 GM_B_Voltage_AC : 1;
SIG_VALTYPE_ 3221225472 GM_B_Voltage_ACDC : 1;
SIG_VALTYPE_ 3221225472 GM_B_Voltage_DC : 1;
SIG_VALTYPE_ 3221225472 GM_B_Voltage_THD : 1;
SIG_VALTYPE_ 3221225472 GM_B_VoltageLL_AC : 1;
SIG_VALTYPE_ 3221225472 GM_B_VoltageLL_ACDC : 1;
SIG_VALTYPE_ 3221225472 GM_B_VoltageLL_DC : 1;
SIG_VALTYPE_ 3221225472 GM_B_Current_ACDC : 1;
SIG_VALTYPE_ 3221225472 GM_B_Current_DC : 1;
SIG_VALTYPE_ 3221225472 GM_B_Current_THD : 1;
SIG_VALTYPE_ 3221225472 GM_B_Crest_Factor : 1;
SIG_VALTYPE_ 3221225472 GM_B_Peak_Current : 1;
SIG_VALTYPE_ 3221225472 GM_B_Peak_Current_Recoded : 1;
SIG_VALTYPE_ 3221225472 GM_B_Active_Power : 1;
SIG_VALTYPE_ 3221225472 GM_B_Power_Factor : 1;
SIG_VALTYPE_ 3221225472 GM_B_Power_Factor_Angle : 1;
SIG_VALTYPE_ 3221225472 GM_B_Displacement_Factor : 1;
SIG_VALTYPE_ 3221225472 GM_B_Distortion_Factor : 1;
SIG_VALTYPE_ 3221225472 GM_B_Kilowatt_Hour : 1;
SIG_VALTYPE_ 3221225472 GM_B_KWH_Elapsed_Time : 1;
SIG_VALTYPE_ 3221225472 GM_C_Frequency : 1;
SIG_VALTYPE_ 3221225472 GM_C_Voltage_AC : 1;
SIG_VALTYPE_ 3221225472 GM_C_Voltage_ACDC : 1;
SIG_VALTYPE_ 3221225472 GM_C_Voltage_DC : 1;
SIG_VALTYPE_ 3221225472 GM_C_Voltage_THD : 1;
SIG_VALTYPE_ 3221225472 GM_C_VoltageLL_AC : 1;
SIG_VALTYPE_ 3221225472 GM_C_VoltageLL_ACDC : 1;
SIG_VALTYPE_ 3221225472 GM_C_VoltageLL_DC : 1;
SIG_VALTYPE_ 3221225472 GM_C_Current_ACDC : 1;
SIG_VALTYPE_ 3221225472 GM_C_Current_DC : 1;
SIG_VALTYPE_ 3221225472 GM_C_Current_THD : 1;
SIG_VALTYPE_ 3221225472 GM_C_Crest_Factor : 1;
SIG_VALTYPE_ 3221225472 GM_C_Peak_Current : 1;
SIG_VALTYPE_ 3221225472 GM_C_Peak_Current_Recoded : 1;
SIG_VALTYPE_ 3221225472 GM_C_Active_Power : 1;
SIG_VALTYPE_ 3221225472 GM_C_Power_Factor : 1;
SIG_VALTYPE_ 3221225472 GM_C_Power_Factor_Angle : 1;
SIG_VALTYPE_ 3221225472 GM_C_Displacement_Factor : 1;
SIG_VALTYPE_ 3221225472 GM_C_Distortion_Factor : 1;
SIG_VALTYPE_ 3221225472 GM_C_Kilowatt_Hour : 1;
SIG_VALTYPE_ 3221225472 GM_C_KWH_Elapsed_Time : 1;
SIG_VALTYPE_ 3221225472 SP_ALL_Frequency : 1;
SIG_VALTYPE_ 3221225472 SP_ALL_Phase : 1;
SIG_VALTYPE_ 3221225472 SP_ALL_Voltage_AC : 1;
SIG_VALTYPE_ 3221225472 SP_ALL_Voltage_DC : 1;
SIG_VALTYPE_ 3221225472 SP_ALL_Current_Limit : 1;
SIG_VALTYPE_ 3221225472 SP_ALL_KVA_Limit : 1;
SIG_VALTYPE_ 3221225472 SP_ALL_Power_Limit : 1;
SIG_VALTYPE_ 3221225472 SP_A_Frequency : 1;
SIG_VALTYPE_ 3221225472 SP_A_Phase : 1;
SIG_VALTYPE_ 3221225472 SP_A_Voltage_AC : 1;
SIG_VALTYPE_ 3221225472 SP_A_Voltage_DC : 1;
SIG_VALTYPE_ 3221225472 SP_A_Current_Limit : 1;
SIG_VALTYPE_ 3221225472 SP_A_KVA_Limit : 1;
SIG_VALTYPE_ 3221225472 SP_A_Power_Limit : 1;
SIG_VALTYPE_ 3221225472 SP_B_Frequency : 1;
SIG_VALTYPE_ 3221225472 SP_B_Phase : 1;
SIG_VALTYPE_ 3221225472 SP_B_Voltage_AC : 1;
SIG_VALTYPE_ 3221225472 SP_B_Voltage_DC : 1;
SIG_VALTYPE_ 3221225472 SP_B_Current_Limit : 1;
SIG_VALTYPE_ 3221225472 SP_B_KVA_Limit : 1;
SIG_VALTYPE_ 3221225472 SP_B_Power_Limit : 1;
SIG_VALTYPE_ 3221225472 SP_C_Frequency : 1;
SIG_VALTYPE_ 3221225472 SP_C_Phase : 1;
SIG_VALTYPE_ 3221225472 SP_C_Voltage_AC : 1;
SIG_VALTYPE_ 3221225472 SP_C_Voltage_DC : 1;
SIG_VALTYPE_ 3221225472 SP_C_Current_Limit : 1;
SIG_VALTYPE_ 3221225472 SP_C_KVA_Limit : 1;
SIG_VALTYPE_ 3221225472 SP_C_Power_Limit : 1;
SIG_VALTYPE_ 3221225472 GP_ALL_Frequency : 1;
SIG_VALTYPE_ 3221225472 GP_ALL_Phase : 1;
SIG_VALTYPE_ 3221225472 GP_ALL_Voltage_AC : 1;
SIG_VALTYPE_ 3221225472 GP_ALL_Voltage_DC : 1;
SIG_VALTYPE_ 3221225472 GP_ALL_Current_Limit : 1;
SIG_VALTYPE_ 3221225472 GP_ALL_KVA_Limit : 1;
SIG_VALTYPE_ 3221225472 GP_ALL_Power_Limit : 1;
SIG_VALTYPE_ 3221225472 GP_A_Frequency : 1;
SIG_VALTYPE_ 3221225472 GP_A_Phase : 1;
SIG_VALTYPE_ 3221225472 GP_A_Voltage_AC : 1;
SIG_VALTYPE_ 3221225472 GP_A_Voltage_DC : 1;
SIG_VALTYPE_ 3221225472 GP_A_Current_Limit : 1;
SIG_VALTYPE_ 3221225472 GP_A_KVA_Limit : 1;
SIG_VALTYPE_ 3221225472 GP_A_Power_Limit : 1;
SIG_VALTYPE_ 3221225472 GP_B_Frequency : 1;
SIG_VALTYPE_ 3221225472 GP_B_Phase : 1;
SIG_VALTYPE_ 3221225472 GP_B_Voltage_AC : 1;
SIG_VALTYPE_ 3221225472 GP_B_Voltage_DC : 1;
SIG_VALTYPE_ 3221225472 GP_B_Current_Limit : 1;
SIG_VALTYPE_ 3221225472 GP_B_KVA_Limit : 1;
SIG_VALTYPE_ 3221225472 GP_B_Power_Limit : 1;
SIG_VALTYPE_ 3221225472 GP_C_Frequency : 1;
SIG_VALTYPE_ 3221225472 GP_C_Phase : 1;
SIG_VALTYPE_ 3221225472 GP_C_Voltage_AC : 1;
SIG_VALTYPE_ 3221225472 GP_C_Voltage_DC : 1;
SIG_VALTYPE_ 3221225472 GP_C_Current_Limit : 1;
SIG_VALTYPE_ 3221225472 GP_C_KVA_Limit : 1;
SIG_VALTYPE_ 3221225472 GP_C_Power_Limit : 1;
SIG_VALTYPE_ 3221225472 SPP_Peak_Current_Limit : 1;
SIG_VALTYPE_ 3221225472 SPP_Peak_Voltage_Level : 1;
SIG_VALTYPE_ 3221225472 SPP_Peak_Voltage_Margin : 1;
SIG_VALTYPE_ 3221225472 SPP_Peak_Current_Level : 1;
SIG_VALTYPE_ 3221225472 SPP_RMS_Current_Level : 1;
SIG_VALTYPE_ 3221225472 SPP_RMS_Power_Level : 1;
SIG_VALTYPE_ 3221225472 SPP_RMS_KVA_Level : 1;
SIG_VALTYPE_ 3221225472 SPP_RMS_Trip_Time : 1;
SIG_VALTYPE_ 3221225472 GPP_Peak_Current_Limit : 1;
SIG_VALTYPE_ 3221225472 GPP_Peak_Voltage_Level : 1;
SIG_VALTYPE_ 3221225472 GPP_Peak_Voltage_Margin : 1;
SIG_VALTYPE_ 3221225472 GPP_Peak_Current_Level : 1;
SIG_VALTYPE_ 3221225472 GPP_RMS_Current_Level : 1;
SIG_VALTYPE_ 3221225472 GPP_RMS_Power_Level : 1;
SIG_VALTYPE_ 3221225472 GPP_RMS_KVA_Level : 1;
SIG_VALTYPE_ 3221225472 GPP_RMS_Trip_Time : 1;
SIG_VALTYPE_ 3221225472 SC_Update_Phase : 1;
SIG_VALTYPE_ 3221225472 SC_Output_Disable_Phase : 1;
SIG_VALTYPE_ 3221225472 SC_CSC_Max_Gain : 1;
SIG_VALTYPE_ 3221225472 GC_Update_Phase : 1;
SIG_VALTYPE_ 3221225472 GC_Output_Disable_Phase : 1;
SIG_VALTYPE_ 3221225472 GC_CSC_Max_Gain : 1;
SIG_VALTYPE_ 3221225472 SC_Ramp_Time : 1;
SIG_VALTYPE_ 3221225472 SC_Slew_Frequency : 1;
SIG_VALTYPE_ 3221225472 SC_Slew_Phase : 1;
SIG_VALTYPE_ 3221225472 SC_Slew_Voltage_AC : 1;
SIG_VALTYPE_ 3221225472 SC_Slew_Voltage_DC : 1;
SIG_VALTYPE_ 3221225472 GC_Ramp_Time : 1;
SIG_VALTYPE_ 3221225472 GC_Slew_Frequency : 1;
SIG_VALTYPE_ 3221225472 GC_Slew_Phase : 1;
SIG_VALTYPE_ 3221225472 GC_Slew_Voltage_AC : 1;
SIG_VALTYPE_ 3221225472 GC_Slew_Voltage_DC : 1;
